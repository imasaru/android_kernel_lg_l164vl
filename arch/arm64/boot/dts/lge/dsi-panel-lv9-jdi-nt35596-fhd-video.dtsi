/* Copyright (c) 2014, Code Aurora Forum. All rights reserved.
 *
 * This program is free software; you can redistribute it and/or modify
 * it under the terms of the GNU General Public License version 2 and
 * only version 2 as published by the Free Software Foundation.
 *
 * This program is distributed in the hope that it will be useful,
 * but WITHOUT ANY WARRANTY; without even the implied warranty of
 * MERCHANTABILITY or FITNESS FOR A PARTICULAR PURPOSE.  See the
 * GNU General Public License for more details.
 */

&mdss_mdp {
	dsi_lv9_jdi_nt35596_vid: qcom,mdss_dsi_lv9_jdi_nt35596_fhd_video {
		compatible = "qcom,mdss-dsi-panel";
		qcom,mdss-dsi-panel-name = "JDI FHD video mode dsi panel";
		qcom,mdss-dsi-panel-controller = <&mdss_dsi0>;
		qcom,mdss-dsi-panel-type = "dsi_video_mode";
		qcom,mdss-dsi-panel-destination = "display_1";
		qcom,mdss-dsi-panel-framerate = <60>;
		qcom,mdss-dsi-virtual-channel-id = <0>;
		qcom,mdss-dsi-stream = <0>;

		qcom,mdss-dsi-panel-width = <1080>;
		qcom,mdss-dsi-panel-height = <1920>;
		qcom,mdss-dsi-h-front-porch = <24>;
		qcom,mdss-dsi-h-back-porch = <96>;
		qcom,mdss-dsi-h-pulse-width = <4>;
		qcom,mdss-dsi-h-sync-skew = <0>;
		qcom,mdss-dsi-v-back-porch = <3>;
		qcom,mdss-dsi-v-front-porch = <4>;
		qcom,mdss-dsi-v-pulse-width = <1>;


		qcom,mdss-pan-physical-width-dimension = <65>;
		qcom,mdss-pan-physical-height-dimension = <115>;

		qcom,mdss-dsi-h-left-border = <0>;
		qcom,mdss-dsi-h-right-border = <0>;
		qcom,mdss-dsi-v-top-border = <0>;
		qcom,mdss-dsi-v-bottom-border = <0>;
		qcom,mdss-dsi-bpp = <24>;
		qcom,mdss-dsi-color-order = "rgb_swap_rgb";
		qcom,mdss-dsi-underflow-color = <0xff>;
		qcom,mdss-dsi-border-color = <0xff>;

		qcom,mdss-dsi-on-command = [
			/* Preset Monochrome mode */
			15 01 00 00 00 00 02 FF 22
			15 01 00 00 00 00 02 00 AA
			15 01 00 00 00 00 02 01 AA
			15 01 00 00 00 00 02 02 AA
			15 01 00 00 00 00 02 03 AA
			15 01 00 00 00 00 02 04 AA
			15 01 00 00 00 00 02 05 AA
			15 01 00 00 00 00 02 06 AA
			15 01 00 00 00 00 02 07 AA
			15 01 00 00 00 00 02 08 AA
			15 01 00 00 00 00 02 09 AA
			15 01 00 00 00 00 02 0A AA
			15 01 00 00 00 00 02 0B AA
			15 01 00 00 00 00 02 0C AA
			15 01 00 00 00 00 02 0D AA
			15 01 00 00 00 00 02 0E AA
			15 01 00 00 00 00 02 0F AA
			15 01 00 00 00 00 02 10 AA
			15 01 00 00 00 00 02 11 AA
			15 01 00 00 00 00 02 12 AA
			15 01 00 00 00 00 02 13 AA
			15 01 00 00 00 00 02 14 20
			15 01 00 00 00 00 02 1A 01
			15 01 00 00 00 00 02 55 00
			15 01 00 00 00 00 02 56 00
			15 01 00 00 00 00 02 58 00
			15 01 00 00 00 00 02 68 00
			15 01 00 00 00 00 02 84 FF
			15 01 00 00 00 00 02 85 FF
			15 01 00 00 00 00 02 86 0F
			15 01 00 00 00 00 02 FB 01

			15 01 00 00 00 00 02 FF 10
			15 01 00 00 00 00 02 35 01
			15 01 00 00 00 00 02 51 FF
			15 01 00 00 00 00 02 53 24
			15 01 00 00 00 00 02 55 00
			15 01 00 00 28 00 02 B0 00 /* wait time 40ms befor sleep out */

			/* Sleep out */
			05 01 00 00 78 00 01 11
			/* Display On */
			05 01 00 00 00 00 01 29
		];

		qcom,mdss-dsi-off-command = [
			/* Display off */
			05 01 00 00 28 00 01 28
			/* Sleep in */
			05 01 00 00 78 00 01 10
		];

		qcom,panel-normal-mode-initial-gamma-command = [
			//page selection cmd start
			15 01 00 00 00 00 02 FF 20
			//R(+) MCR cmd
			15 01 00 00 00 00 02 75 00
			15 01 00 00 00 00 02 76 00
			15 01 00 00 00 00 02 77 00
			15 01 00 00 00 00 02 78 1F
			15 01 00 00 00 00 02 79 00
			15 01 00 00 00 00 02 7A 56
			15 01 00 00 00 00 02 7B 00
			15 01 00 00 00 00 02 7C 7F
			15 01 00 00 00 00 02 7D 00
			15 01 00 00 00 00 02 7E 9E
			15 01 00 00 00 00 02 7F 00
			15 01 00 00 00 00 02 80 B8
			15 01 00 00 00 00 02 81 00
			15 01 00 00 00 00 02 82 CE
			15 01 00 00 00 00 02 83 00
			15 01 00 00 00 00 02 84 E2
			15 01 00 00 00 00 02 85 00
			15 01 00 00 00 00 02 86 F4
			15 01 00 00 00 00 02 87 01
			15 01 00 00 00 00 02 88 2D
			15 01 00 00 00 00 02 89 01
			15 01 00 00 00 00 02 8A 58
			15 01 00 00 00 00 02 8B 01
			15 01 00 00 00 00 02 8C 97
			15 01 00 00 00 00 02 8D 01
			15 01 00 00 00 00 02 8E C7
			15 01 00 00 00 00 02 8F 02
			15 01 00 00 00 00 02 90 0D
			15 01 00 00 00 00 02 91 02
			15 01 00 00 00 00 02 92 42
			15 01 00 00 00 00 02 93 02
			15 01 00 00 00 00 02 94 44
			15 01 00 00 00 00 02 95 02
			15 01 00 00 00 00 02 96 79
			15 01 00 00 00 00 02 97 02
			15 01 00 00 00 00 02 98 B4
			15 01 00 00 00 00 02 99 02
			15 01 00 00 00 00 02 9A DA
			15 01 00 00 00 00 02 9B 03
			15 01 00 00 00 00 02 9C 0B
			15 01 00 00 00 00 02 9D 03
			15 01 00 00 00 00 02 9E 2F
			15 01 00 00 00 00 02 9F 03
			15 01 00 00 00 00 02 A0 60
			15 01 00 00 00 00 02 A2 03
			15 01 00 00 00 00 02 A3 70
			15 01 00 00 00 00 02 A4 03
			15 01 00 00 00 00 02 A5 81
			15 01 00 00 00 00 02 A6 03
			15 01 00 00 00 00 02 A7 93
			15 01 00 00 00 00 02 A9 03
			15 01 00 00 00 00 02 AA A7
			15 01 00 00 00 00 02 AB 03
			15 01 00 00 00 00 02 AC BE
			15 01 00 00 00 00 02 AD 03
			15 01 00 00 00 00 02 AE D6
			15 01 00 00 00 00 02 AF 03
			15 01 00 00 00 00 02 B0 F1
			15 01 00 00 00 00 02 B1 03
			15 01 00 00 00 00 02 B2 FF
			//R(-) MCR cmd
			15 01 00 00 00 00 02 B3 00
			15 01 00 00 00 00 02 B4 00
			15 01 00 00 00 00 02 B5 00
			15 01 00 00 00 00 02 B6 1F
			15 01 00 00 00 00 02 B7 00
			15 01 00 00 00 00 02 B8 56
			15 01 00 00 00 00 02 B9 00
			15 01 00 00 00 00 02 BA 7F
			15 01 00 00 00 00 02 BB 00
			15 01 00 00 00 00 02 BC 9E
			15 01 00 00 00 00 02 BD 00
			15 01 00 00 00 00 02 BE B8
			15 01 00 00 00 00 02 BF 00
			15 01 00 00 00 00 02 C0 CE
			15 01 00 00 00 00 02 C1 00
			15 01 00 00 00 00 02 C2 E2
			15 01 00 00 00 00 02 C3 00
			15 01 00 00 00 00 02 C4 F4
			15 01 00 00 00 00 02 C5 01
			15 01 00 00 00 00 02 C6 2D
			15 01 00 00 00 00 02 C7 01
			15 01 00 00 00 00 02 C8 58
			15 01 00 00 00 00 02 C9 01
			15 01 00 00 00 00 02 CA 97
			15 01 00 00 00 00 02 CB 01
			15 01 00 00 00 00 02 CC C7
			15 01 00 00 00 00 02 CD 02
			15 01 00 00 00 00 02 CE 0D
			15 01 00 00 00 00 02 CF 02
			15 01 00 00 00 00 02 D0 42
			15 01 00 00 00 00 02 D1 02
			15 01 00 00 00 00 02 D2 44
			15 01 00 00 00 00 02 D3 02
			15 01 00 00 00 00 02 D4 79
			15 01 00 00 00 00 02 D5 02
			15 01 00 00 00 00 02 D6 B4
			15 01 00 00 00 00 02 D7 02
			15 01 00 00 00 00 02 D8 DA
			15 01 00 00 00 00 02 D9 03
			15 01 00 00 00 00 02 DA 0B
			15 01 00 00 00 00 02 DB 03
			15 01 00 00 00 00 02 DC 2F
			15 01 00 00 00 00 02 DD 03
			15 01 00 00 00 00 02 DE 60
			15 01 00 00 00 00 02 DF 03
			15 01 00 00 00 00 02 E0 70
			15 01 00 00 00 00 02 E1 03
			15 01 00 00 00 00 02 E2 81
			15 01 00 00 00 00 02 E3 03
			15 01 00 00 00 00 02 E4 93
			15 01 00 00 00 00 02 E5 03
			15 01 00 00 00 00 02 E6 A7
			15 01 00 00 00 00 02 E7 03
			15 01 00 00 00 00 02 E8 BE
			15 01 00 00 00 00 02 E9 03
			15 01 00 00 00 00 02 EA D6
			15 01 00 00 00 00 02 EB 03
			15 01 00 00 00 00 02 EC F1
			15 01 00 00 00 00 02 ED 03
			15 01 00 00 00 00 02 EE FF
			//G(+) MCR cmd
			15 01 00 00 00 00 02 EF 00
			15 01 00 00 00 00 02 F0 00
			15 01 00 00 00 00 02 F1 00
			15 01 00 00 00 00 02 F2 20
			15 01 00 00 00 00 02 F3 00
			15 01 00 00 00 00 02 F4 59
			15 01 00 00 00 00 02 F5 00
			15 01 00 00 00 00 02 F6 82
			15 01 00 00 00 00 02 F7 00
			15 01 00 00 00 00 02 F8 A0
			15 01 00 00 00 00 02 F9 00
			15 01 00 00 00 00 02 FA BA
			//page selection cmd start
			15 01 00 00 00 00 02 FB 01
			15 01 00 00 00 00 02 FF 21
			//page selection cmd end
			15 01 00 00 00 00 02 00 00
			15 01 00 00 00 00 02 01 D0
			15 01 00 00 00 00 02 02 00
			15 01 00 00 00 00 02 03 E4
			15 01 00 00 00 00 02 04 00
			15 01 00 00 00 00 02 05 F5
			15 01 00 00 00 00 02 06 01
			15 01 00 00 00 00 02 07 2F
			15 01 00 00 00 00 02 08 01
			15 01 00 00 00 00 02 09 59
			15 01 00 00 00 00 02 0A 01
			15 01 00 00 00 00 02 0B 98
			15 01 00 00 00 00 02 0C 01
			15 01 00 00 00 00 02 0D C6
			15 01 00 00 00 00 02 0E 02
			15 01 00 00 00 00 02 0F 0D
			15 01 00 00 00 00 02 10 02
			15 01 00 00 00 00 02 11 43
			15 01 00 00 00 00 02 12 02
			15 01 00 00 00 00 02 13 44
			15 01 00 00 00 00 02 14 02
			15 01 00 00 00 00 02 15 79
			15 01 00 00 00 00 02 16 02
			15 01 00 00 00 00 02 17 B4
			15 01 00 00 00 00 02 18 02
			15 01 00 00 00 00 02 19 DA
			15 01 00 00 00 00 02 1A 03
			15 01 00 00 00 00 02 1B 0C
			15 01 00 00 00 00 02 1C 03
			15 01 00 00 00 00 02 1D 30
			15 01 00 00 00 00 02 1E 03
			15 01 00 00 00 00 02 1F 61
			15 01 00 00 00 00 02 20 03
			15 01 00 00 00 00 02 21 71
			15 01 00 00 00 00 02 22 03
			15 01 00 00 00 00 02 23 82
			15 01 00 00 00 00 02 24 03
			15 01 00 00 00 00 02 25 94
			15 01 00 00 00 00 02 26 03
			15 01 00 00 00 00 02 27 A8
			15 01 00 00 00 00 02 28 03
			15 01 00 00 00 00 02 29 BE
			15 01 00 00 00 00 02 2A 03
			15 01 00 00 00 00 02 2B D7
			15 01 00 00 00 00 02 2D 03
			15 01 00 00 00 00 02 2F F1
			15 01 00 00 00 00 02 30 03
			15 01 00 00 00 00 02 31 FF
			//G(-) MCR cmd
			15 01 00 00 00 00 02 32 00
			15 01 00 00 00 00 02 33 00
			15 01 00 00 00 00 02 34 00
			15 01 00 00 00 00 02 35 20
			15 01 00 00 00 00 02 36 00
			15 01 00 00 00 00 02 37 59
			15 01 00 00 00 00 02 38 00
			15 01 00 00 00 00 02 39 82
			15 01 00 00 00 00 02 3A 00
			15 01 00 00 00 00 02 3B A0
			15 01 00 00 00 00 02 3D 00
			15 01 00 00 00 00 02 3F BA
			15 01 00 00 00 00 02 40 00
			15 01 00 00 00 00 02 41 D0
			15 01 00 00 00 00 02 42 00
			15 01 00 00 00 00 02 43 E4
			15 01 00 00 00 00 02 44 00
			15 01 00 00 00 00 02 45 F5
			15 01 00 00 00 00 02 46 01
			15 01 00 00 00 00 02 47 2F
			15 01 00 00 00 00 02 48 01
			15 01 00 00 00 00 02 49 59
			15 01 00 00 00 00 02 4A 01
			15 01 00 00 00 00 02 4B 98
			15 01 00 00 00 00 02 4C 01
			15 01 00 00 00 00 02 4D C6
			15 01 00 00 00 00 02 4E 02
			15 01 00 00 00 00 02 4F 0D
			15 01 00 00 00 00 02 50 02
			15 01 00 00 00 00 02 51 43
			15 01 00 00 00 00 02 52 02
			15 01 00 00 00 00 02 53 44
			15 01 00 00 00 00 02 54 02
			15 01 00 00 00 00 02 55 79
			15 01 00 00 00 00 02 56 02
			15 01 00 00 00 00 02 58 B4
			15 01 00 00 00 00 02 59 02
			15 01 00 00 00 00 02 5A DA
			15 01 00 00 00 00 02 5B 03
			15 01 00 00 00 00 02 5C 0C
			15 01 00 00 00 00 02 5D 03
			15 01 00 00 00 00 02 5E 30
			15 01 00 00 00 00 02 5F 03
			15 01 00 00 00 00 02 60 61
			15 01 00 00 00 00 02 61 03
			15 01 00 00 00 00 02 62 71
			15 01 00 00 00 00 02 63 03
			15 01 00 00 00 00 02 64 82
			15 01 00 00 00 00 02 65 03
			15 01 00 00 00 00 02 66 94
			15 01 00 00 00 00 02 67 03
			15 01 00 00 00 00 02 68 A8
			15 01 00 00 00 00 02 69 03
			15 01 00 00 00 00 02 6A BE
			15 01 00 00 00 00 02 6B 03
			15 01 00 00 00 00 02 6C D7
			15 01 00 00 00 00 02 6D 03
			15 01 00 00 00 00 02 6E F1
			15 01 00 00 00 00 02 6F 03
			15 01 00 00 00 00 02 70 FF
			//B(+) MCR cmd
			15 01 00 00 00 00 02 71 00
			15 01 00 00 00 00 02 72 00
			15 01 00 00 00 00 02 73 00
			15 01 00 00 00 00 02 74 23
			15 01 00 00 00 00 02 75 00
			15 01 00 00 00 00 02 76 61
			15 01 00 00 00 00 02 77 00
			15 01 00 00 00 00 02 78 8C
			15 01 00 00 00 00 02 79 00
			15 01 00 00 00 00 02 7A AA
			15 01 00 00 00 00 02 7B 00
			15 01 00 00 00 00 02 7C C3
			15 01 00 00 00 00 02 7D 00
			15 01 00 00 00 00 02 7E DA
			15 01 00 00 00 00 02 7F 00
			15 01 00 00 00 00 02 80 EE
			15 01 00 00 00 00 02 81 00
			15 01 00 00 00 00 02 82 FF
			15 01 00 00 00 00 02 83 01
			15 01 00 00 00 00 02 84 37
			15 01 00 00 00 00 02 85 01
			15 01 00 00 00 00 02 86 61
			15 01 00 00 00 00 02 87 01
			15 01 00 00 00 00 02 88 A0
			15 01 00 00 00 00 02 89 01
			15 01 00 00 00 00 02 8A CE
			15 01 00 00 00 00 02 8B 02
			15 01 00 00 00 00 02 8C 12
			15 01 00 00 00 00 02 8D 02
			15 01 00 00 00 00 02 8E 49
			15 01 00 00 00 00 02 8F 02
			15 01 00 00 00 00 02 90 4A
			15 01 00 00 00 00 02 91 02
			15 01 00 00 00 00 02 92 7C
			15 01 00 00 00 00 02 93 02
			15 01 00 00 00 00 02 94 B7
			15 01 00 00 00 00 02 95 02
			15 01 00 00 00 00 02 96 DC
			15 01 00 00 00 00 02 97 03
			15 01 00 00 00 00 02 98 0E
			15 01 00 00 00 00 02 99 03
			15 01 00 00 00 00 02 9A 31
			15 01 00 00 00 00 02 9B 03
			15 01 00 00 00 00 02 9C 63
			15 01 00 00 00 00 02 9D 03
			15 01 00 00 00 00 02 9E 72
			15 01 00 00 00 00 02 9F 03
			15 01 00 00 00 00 02 A0 83
			15 01 00 00 00 00 02 A2 03
			15 01 00 00 00 00 02 A3 95
			15 01 00 00 00 00 02 A4 03
			15 01 00 00 00 00 02 A5 A9
			15 01 00 00 00 00 02 A6 03
			15 01 00 00 00 00 02 A7 BF
			15 01 00 00 00 00 02 A9 03
			15 01 00 00 00 00 02 AA D7
			15 01 00 00 00 00 02 AB 03
			15 01 00 00 00 00 02 AC F2
			15 01 00 00 00 00 02 AD 03
			15 01 00 00 00 00 02 AE FF
			//B(-) MCR cmd
			15 01 00 00 00 00 02 AF 00
			15 01 00 00 00 00 02 B0 00
			15 01 00 00 00 00 02 B1 00
			15 01 00 00 00 00 02 B2 23
			15 01 00 00 00 00 02 B3 00
			15 01 00 00 00 00 02 B4 61
			15 01 00 00 00 00 02 B5 00
			15 01 00 00 00 00 02 B6 8C
			15 01 00 00 00 00 02 B7 00
			15 01 00 00 00 00 02 B8 AA
			15 01 00 00 00 00 02 B9 00
			15 01 00 00 00 00 02 BA C3
			15 01 00 00 00 00 02 BB 00
			15 01 00 00 00 00 02 BC DA
			15 01 00 00 00 00 02 BD 00
			15 01 00 00 00 00 02 BE EE
			15 01 00 00 00 00 02 BF 00
			15 01 00 00 00 00 02 C0 FF
			15 01 00 00 00 00 02 C1 01
			15 01 00 00 00 00 02 C2 37
			15 01 00 00 00 00 02 C3 01
			15 01 00 00 00 00 02 C4 61
			15 01 00 00 00 00 02 C5 01
			15 01 00 00 00 00 02 C6 A0
			15 01 00 00 00 00 02 C7 01
			15 01 00 00 00 00 02 C8 CE
			15 01 00 00 00 00 02 C9 02
			15 01 00 00 00 00 02 CA 12
			15 01 00 00 00 00 02 CB 02
			15 01 00 00 00 00 02 CC 49
			15 01 00 00 00 00 02 CD 02
			15 01 00 00 00 00 02 CE 4A
			15 01 00 00 00 00 02 CF 02
			15 01 00 00 00 00 02 D0 7C
			15 01 00 00 00 00 02 D1 02
			15 01 00 00 00 00 02 D2 B7
			15 01 00 00 00 00 02 D3 02
			15 01 00 00 00 00 02 D4 DC
			15 01 00 00 00 00 02 D5 03
			15 01 00 00 00 00 02 D6 0E
			15 01 00 00 00 00 02 D7 03
			15 01 00 00 00 00 02 D8 31
			15 01 00 00 00 00 02 D9 03
			15 01 00 00 00 00 02 DA 63
			15 01 00 00 00 00 02 DB 03
			15 01 00 00 00 00 02 DC 72
			15 01 00 00 00 00 02 DD 03
			15 01 00 00 00 00 02 DE 83
			15 01 00 00 00 00 02 DF 03
			15 01 00 00 00 00 02 E0 95
			15 01 00 00 00 00 02 E1 03
			15 01 00 00 00 00 02 E2 A9
			15 01 00 00 00 00 02 E3 03
			15 01 00 00 00 00 02 E4 BF
			15 01 00 00 00 00 02 E5 03
			15 01 00 00 00 00 02 E6 D7
			15 01 00 00 00 00 02 E7 03
			15 01 00 00 00 00 02 E8 F2
			15 01 00 00 00 00 02 E9 03
			15 01 00 00 00 00 02 EA FF
			15 01 00 00 00 00 02 FB 01
		];

		qcom,panel-reader-mode-initial-step1-command = [
			//page selection cmd start
			15 01 00 00 00 00 02 FF 20
			//R(+) MCR cmd
			15 01 00 00 00 00 02 75 00
			15 01 00 00 00 00 02 76 00
			15 01 00 00 00 00 02 77 00
			15 01 00 00 00 00 02 78 1F
			15 01 00 00 00 00 02 79 00
			15 01 00 00 00 00 02 7A 56
			15 01 00 00 00 00 02 7B 00
			15 01 00 00 00 00 02 7C 7F
			15 01 00 00 00 00 02 7D 00
			15 01 00 00 00 00 02 7E 9E
			15 01 00 00 00 00 02 7F 00
			15 01 00 00 00 00 02 80 B8
			15 01 00 00 00 00 02 81 00
			15 01 00 00 00 00 02 82 CE
			15 01 00 00 00 00 02 83 00
			15 01 00 00 00 00 02 84 E2
			15 01 00 00 00 00 02 85 00
			15 01 00 00 00 00 02 86 F4
			15 01 00 00 00 00 02 87 01
			15 01 00 00 00 00 02 88 2D
			15 01 00 00 00 00 02 89 01
			15 01 00 00 00 00 02 8A 58
			15 01 00 00 00 00 02 8B 01
			15 01 00 00 00 00 02 8C 97
			15 01 00 00 00 00 02 8D 01
			15 01 00 00 00 00 02 8E C7
			15 01 00 00 00 00 02 8F 02
			15 01 00 00 00 00 02 90 0D
			15 01 00 00 00 00 02 91 02
			15 01 00 00 00 00 02 92 42
			15 01 00 00 00 00 02 93 02
			15 01 00 00 00 00 02 94 44
			15 01 00 00 00 00 02 95 02
			15 01 00 00 00 00 02 96 79
			15 01 00 00 00 00 02 97 02
			15 01 00 00 00 00 02 98 B4
			15 01 00 00 00 00 02 99 02
			15 01 00 00 00 00 02 9A DA
			15 01 00 00 00 00 02 9B 03
			15 01 00 00 00 00 02 9C 0B
			15 01 00 00 00 00 02 9D 03
			15 01 00 00 00 00 02 9E 2F
			15 01 00 00 00 00 02 9F 03
			15 01 00 00 00 00 02 A0 60
			15 01 00 00 00 00 02 A2 03
			15 01 00 00 00 00 02 A3 70
			15 01 00 00 00 00 02 A4 03
			15 01 00 00 00 00 02 A5 81
			15 01 00 00 00 00 02 A6 03
			15 01 00 00 00 00 02 A7 93
			15 01 00 00 00 00 02 A9 03
			15 01 00 00 00 00 02 AA A7
			15 01 00 00 00 00 02 AB 03
			15 01 00 00 00 00 02 AC BE
			15 01 00 00 00 00 02 AD 03
			15 01 00 00 00 00 02 AE D6
			15 01 00 00 00 00 02 AF 03
			15 01 00 00 00 00 02 B0 F1
			15 01 00 00 00 00 02 B1 03
			15 01 00 00 00 00 02 B2 FF
			//R(-) MCR cmd
			15 01 00 00 00 00 02 B3 00
			15 01 00 00 00 00 02 B4 00
			15 01 00 00 00 00 02 B5 00
			15 01 00 00 00 00 02 B6 1F
			15 01 00 00 00 00 02 B7 00
			15 01 00 00 00 00 02 B8 56
			15 01 00 00 00 00 02 B9 00
			15 01 00 00 00 00 02 BA 7F
			15 01 00 00 00 00 02 BB 00
			15 01 00 00 00 00 02 BC 9E
			15 01 00 00 00 00 02 BD 00
			15 01 00 00 00 00 02 BE B8
			15 01 00 00 00 00 02 BF 00
			15 01 00 00 00 00 02 C0 CE
			15 01 00 00 00 00 02 C1 00
			15 01 00 00 00 00 02 C2 E2
			15 01 00 00 00 00 02 C3 00
			15 01 00 00 00 00 02 C4 F4
			15 01 00 00 00 00 02 C5 01
			15 01 00 00 00 00 02 C6 2D
			15 01 00 00 00 00 02 C7 01
			15 01 00 00 00 00 02 C8 58
			15 01 00 00 00 00 02 C9 01
			15 01 00 00 00 00 02 CA 97
			15 01 00 00 00 00 02 CB 01
			15 01 00 00 00 00 02 CC C7
			15 01 00 00 00 00 02 CD 02
			15 01 00 00 00 00 02 CE 0D
			15 01 00 00 00 00 02 CF 02
			15 01 00 00 00 00 02 D0 42
			15 01 00 00 00 00 02 D1 02
			15 01 00 00 00 00 02 D2 44
			15 01 00 00 00 00 02 D3 02
			15 01 00 00 00 00 02 D4 79
			15 01 00 00 00 00 02 D5 02
			15 01 00 00 00 00 02 D6 B4
			15 01 00 00 00 00 02 D7 02
			15 01 00 00 00 00 02 D8 DA
			15 01 00 00 00 00 02 D9 03
			15 01 00 00 00 00 02 DA 0B
			15 01 00 00 00 00 02 DB 03
			15 01 00 00 00 00 02 DC 2F
			15 01 00 00 00 00 02 DD 03
			15 01 00 00 00 00 02 DE 60
			15 01 00 00 00 00 02 DF 03
			15 01 00 00 00 00 02 E0 70
			15 01 00 00 00 00 02 E1 03
			15 01 00 00 00 00 02 E2 81
			15 01 00 00 00 00 02 E3 03
			15 01 00 00 00 00 02 E4 93
			15 01 00 00 00 00 02 E5 03
			15 01 00 00 00 00 02 E6 A7
			15 01 00 00 00 00 02 E7 03
			15 01 00 00 00 00 02 E8 BE
			15 01 00 00 00 00 02 E9 03
			15 01 00 00 00 00 02 EA D6
			15 01 00 00 00 00 02 EB 03
			15 01 00 00 00 00 02 EC F1
			15 01 00 00 00 00 02 ED 03
			15 01 00 00 00 00 02 EE FF
			//G(+) MCR cmd
			15 01 00 00 00 00 02 EF 00
			15 01 00 00 00 00 02 F0 CD
			15 01 00 00 00 00 02 F1 00
			15 01 00 00 00 00 02 F2 D7
			15 01 00 00 00 00 02 F3 00
			15 01 00 00 00 00 02 F4 E9
			15 01 00 00 00 00 02 F5 00
			15 01 00 00 00 00 02 F6 F8
			15 01 00 00 00 00 02 F7 01
			15 01 00 00 00 00 02 F8 07
			15 01 00 00 00 00 02 F9 01
			15 01 00 00 00 00 02 FA 15
			//page selection cmd start
			15 01 00 00 00 00 02 FB 01
			15 01 00 00 00 00 02 FF 21
			//page selection cmd end
			15 01 00 00 00 00 02 00 01
			15 01 00 00 00 00 02 01 23
			15 01 00 00 00 00 02 02 01
			15 01 00 00 00 00 02 03 2F
			15 01 00 00 00 00 02 04 01
			15 01 00 00 00 00 02 05 3A
			15 01 00 00 00 00 02 06 01
			15 01 00 00 00 00 02 07 60
			15 01 00 00 00 00 02 08 01
			15 01 00 00 00 00 02 09 7F
			15 01 00 00 00 00 02 0A 01
			15 01 00 00 00 00 02 0B B1
			15 01 00 00 00 00 02 0C 01
			15 01 00 00 00 00 02 0D D8
			15 01 00 00 00 00 02 0E 02
			15 01 00 00 00 00 02 0F 19
			15 01 00 00 00 00 02 10 02
			15 01 00 00 00 00 02 11 4C
			15 01 00 00 00 00 02 12 02
			15 01 00 00 00 00 02 13 4D
			15 01 00 00 00 00 02 14 02
			15 01 00 00 00 00 02 15 81
			15 01 00 00 00 00 02 16 02
			15 01 00 00 00 00 02 17 BA
			15 01 00 00 00 00 02 18 02
			15 01 00 00 00 00 02 19 E0
			15 01 00 00 00 00 02 1A 03
			15 01 00 00 00 00 02 1B 13
			15 01 00 00 00 00 02 1C 03
			15 01 00 00 00 00 02 1D 36
			15 01 00 00 00 00 02 1E 03
			15 01 00 00 00 00 02 1F 67
			15 01 00 00 00 00 02 20 03
			15 01 00 00 00 00 02 21 76
			15 01 00 00 00 00 02 22 03
			15 01 00 00 00 00 02 23 86
			15 01 00 00 00 00 02 24 03
			15 01 00 00 00 00 02 25 98
			15 01 00 00 00 00 02 26 03
			15 01 00 00 00 00 02 27 AC
			15 01 00 00 00 00 02 28 03
			15 01 00 00 00 00 02 29 C1
			15 01 00 00 00 00 02 2A 03
			15 01 00 00 00 00 02 2B D8
			15 01 00 00 00 00 02 2D 03
			15 01 00 00 00 00 02 2F F2
			15 01 00 00 00 00 02 30 03
			15 01 00 00 00 00 02 31 FF
			//G(-) MCR cmd
			15 01 00 00 00 00 02 32 00
			15 01 00 00 00 00 02 33 CD
			15 01 00 00 00 00 02 34 00
			15 01 00 00 00 00 02 35 D7
			15 01 00 00 00 00 02 36 00
			15 01 00 00 00 00 02 37 E9
			15 01 00 00 00 00 02 38 00
			15 01 00 00 00 00 02 39 F8
			15 01 00 00 00 00 02 3A 01
			15 01 00 00 00 00 02 3B 07
			15 01 00 00 00 00 02 3D 01
			15 01 00 00 00 00 02 3F 15
			15 01 00 00 00 00 02 40 01
			15 01 00 00 00 00 02 41 23
			15 01 00 00 00 00 02 42 01
			15 01 00 00 00 00 02 43 2F
			15 01 00 00 00 00 02 44 01
			15 01 00 00 00 00 02 45 3A
			15 01 00 00 00 00 02 46 01
			15 01 00 00 00 00 02 47 60
			15 01 00 00 00 00 02 48 01
			15 01 00 00 00 00 02 49 7F
			15 01 00 00 00 00 02 4A 01
			15 01 00 00 00 00 02 4B B1
			15 01 00 00 00 00 02 4C 01
			15 01 00 00 00 00 02 4D D8
			15 01 00 00 00 00 02 4E 02
			15 01 00 00 00 00 02 4F 19
			15 01 00 00 00 00 02 50 02
			15 01 00 00 00 00 02 51 4C
			15 01 00 00 00 00 02 52 02
			15 01 00 00 00 00 02 53 4D
			15 01 00 00 00 00 02 54 02
			15 01 00 00 00 00 02 55 81
			15 01 00 00 00 00 02 56 02
			15 01 00 00 00 00 02 58 BA
			15 01 00 00 00 00 02 59 02
			15 01 00 00 00 00 02 5A E0
			15 01 00 00 00 00 02 5B 03
			15 01 00 00 00 00 02 5C 13
			15 01 00 00 00 00 02 5D 03
			15 01 00 00 00 00 02 5E 36
			15 01 00 00 00 00 02 5F 03
			15 01 00 00 00 00 02 60 67
			15 01 00 00 00 00 02 61 03
			15 01 00 00 00 00 02 62 76
			15 01 00 00 00 00 02 63 03
			15 01 00 00 00 00 02 64 86
			15 01 00 00 00 00 02 65 03
			15 01 00 00 00 00 02 66 98
			15 01 00 00 00 00 02 67 03
			15 01 00 00 00 00 02 68 AC
			15 01 00 00 00 00 02 69 03
			15 01 00 00 00 00 02 6A C1
			15 01 00 00 00 00 02 6B 03
			15 01 00 00 00 00 02 6C D8
			15 01 00 00 00 00 02 6D 03
			15 01 00 00 00 00 02 6E F2
			15 01 00 00 00 00 02 6F 03
			15 01 00 00 00 00 02 70 FF
			//B(+) MCR cmd
			15 01 00 00 00 00 02 71 01
			15 01 00 00 00 00 02 72 54
			15 01 00 00 00 00 02 73 01
			15 01 00 00 00 00 02 74 59
			15 01 00 00 00 00 02 75 01
			15 01 00 00 00 00 02 76 62
			15 01 00 00 00 00 02 77 01
			15 01 00 00 00 00 02 78 69
			15 01 00 00 00 00 02 79 01
			15 01 00 00 00 00 02 7A 70
			15 01 00 00 00 00 02 7B 01
			15 01 00 00 00 00 02 7C 77
			15 01 00 00 00 00 02 7D 01
			15 01 00 00 00 00 02 7E 7E
			15 01 00 00 00 00 02 7F 01
			15 01 00 00 00 00 02 80 85
			15 01 00 00 00 00 02 81 01
			15 01 00 00 00 00 02 82 8C
			15 01 00 00 00 00 02 83 01
			15 01 00 00 00 00 02 84 A6
			15 01 00 00 00 00 02 85 01
			15 01 00 00 00 00 02 86 BA
			15 01 00 00 00 00 02 87 01
			15 01 00 00 00 00 02 88 DE
			15 01 00 00 00 00 02 89 01
			15 01 00 00 00 00 02 8A FC
			15 01 00 00 00 00 02 8B 02
			15 01 00 00 00 00 02 8C 31
			15 01 00 00 00 00 02 8D 02
			15 01 00 00 00 00 02 8E 5F
			15 01 00 00 00 00 02 8F 02
			15 01 00 00 00 00 02 90 60
			15 01 00 00 00 00 02 91 02
			15 01 00 00 00 00 02 92 8F
			15 01 00 00 00 00 02 93 02
			15 01 00 00 00 00 02 94 C7
			15 01 00 00 00 00 02 95 02
			15 01 00 00 00 00 02 96 EC
			15 01 00 00 00 00 02 97 03
			15 01 00 00 00 00 02 98 1B
			15 01 00 00 00 00 02 99 03
			15 01 00 00 00 00 02 9A 3A
			15 01 00 00 00 00 02 9B 03
			15 01 00 00 00 00 02 9C 67
			15 01 00 00 00 00 02 9D 03
			15 01 00 00 00 00 02 9E 75
			15 01 00 00 00 00 02 9F 03
			15 01 00 00 00 00 02 A0 84
			15 01 00 00 00 00 02 A2 03
			15 01 00 00 00 00 02 A3 96
			15 01 00 00 00 00 02 A4 03
			15 01 00 00 00 00 02 A5 A9
			15 01 00 00 00 00 02 A6 03
			15 01 00 00 00 00 02 A7 BF
			15 01 00 00 00 00 02 A9 03
			15 01 00 00 00 00 02 AA D7
			15 01 00 00 00 00 02 AB 03
			15 01 00 00 00 00 02 AC F1
			15 01 00 00 00 00 02 AD 03
			15 01 00 00 00 00 02 AE FF
			//B(-) MCR cmd
			15 01 00 00 00 00 02 AF 01
			15 01 00 00 00 00 02 B0 54
			15 01 00 00 00 00 02 B1 01
			15 01 00 00 00 00 02 B2 59
			15 01 00 00 00 00 02 B3 01
			15 01 00 00 00 00 02 B4 62
			15 01 00 00 00 00 02 B5 01
			15 01 00 00 00 00 02 B6 69
			15 01 00 00 00 00 02 B7 01
			15 01 00 00 00 00 02 B8 70
			15 01 00 00 00 00 02 B9 01
			15 01 00 00 00 00 02 BA 77
			15 01 00 00 00 00 02 BB 01
			15 01 00 00 00 00 02 BC 7E
			15 01 00 00 00 00 02 BD 01
			15 01 00 00 00 00 02 BE 85
			15 01 00 00 00 00 02 BF 01
			15 01 00 00 00 00 02 C0 8C
			15 01 00 00 00 00 02 C1 01
			15 01 00 00 00 00 02 C2 A6
			15 01 00 00 00 00 02 C3 01
			15 01 00 00 00 00 02 C4 BA
			15 01 00 00 00 00 02 C5 01
			15 01 00 00 00 00 02 C6 DE
			15 01 00 00 00 00 02 C7 01
			15 01 00 00 00 00 02 C8 FC
			15 01 00 00 00 00 02 C9 02
			15 01 00 00 00 00 02 CA 31
			15 01 00 00 00 00 02 CB 02
			15 01 00 00 00 00 02 CC 5F
			15 01 00 00 00 00 02 CD 02
			15 01 00 00 00 00 02 CE 60
			15 01 00 00 00 00 02 CF 02
			15 01 00 00 00 00 02 D0 8F
			15 01 00 00 00 00 02 D1 02
			15 01 00 00 00 00 02 D2 C7
			15 01 00 00 00 00 02 D3 02
			15 01 00 00 00 00 02 D4 EC
			15 01 00 00 00 00 02 D5 03
			15 01 00 00 00 00 02 D6 1B
			15 01 00 00 00 00 02 D7 03
			15 01 00 00 00 00 02 D8 3A
			15 01 00 00 00 00 02 D9 03
			15 01 00 00 00 00 02 DA 67
			15 01 00 00 00 00 02 DB 03
			15 01 00 00 00 00 02 DC 75
			15 01 00 00 00 00 02 DD 03
			15 01 00 00 00 00 02 DE 84
			15 01 00 00 00 00 02 DF 03
			15 01 00 00 00 00 02 E0 96
			15 01 00 00 00 00 02 E1 03
			15 01 00 00 00 00 02 E2 A9
			15 01 00 00 00 00 02 E3 03
			15 01 00 00 00 00 02 E4 BF
			15 01 00 00 00 00 02 E5 03
			15 01 00 00 00 00 02 E6 D7
			15 01 00 00 00 00 02 E7 03
			15 01 00 00 00 00 02 E8 F1
			15 01 00 00 00 00 02 E9 03
			15 01 00 00 00 00 02 EA FF
			//page selection cmd start
			15 01 00 00 00 00 02 FB 01
			15 01 00 00 00 00 02 FF 10
			//page selection cmd end
		];

		qcom,panel-reader-mode-step1-command = [
			//page selection cmd start
			15 00 00 00 00 00 02 FF 20
			//R(+) MCR cmd
			15 00 00 00 00 00 02 75 00
			15 00 00 00 00 00 02 76 00
			15 00 00 00 00 00 02 77 00
			15 00 00 00 00 00 02 78 1F
			15 00 00 00 00 00 02 79 00
			15 00 00 00 00 00 02 7A 56
			15 00 00 00 00 00 02 7B 00
			15 00 00 00 00 00 02 7C 7F
			15 00 00 00 00 00 02 7D 00
			15 00 00 00 00 00 02 7E 9E
			15 00 00 00 00 00 02 7F 00
			15 00 00 00 00 00 02 80 B8
			15 00 00 00 00 00 02 81 00
			15 00 00 00 00 00 02 82 CE
			15 00 00 00 00 00 02 83 00
			15 00 00 00 00 00 02 84 E2
			15 00 00 00 00 00 02 85 00
			15 00 00 00 00 00 02 86 F4
			15 00 00 00 00 00 02 87 01
			15 00 00 00 00 00 02 88 2D
			15 00 00 00 00 00 02 89 01
			15 00 00 00 00 00 02 8A 58
			15 00 00 00 00 00 02 8B 01
			15 00 00 00 00 00 02 8C 97
			15 00 00 00 00 00 02 8D 01
			15 00 00 00 00 00 02 8E C7
			15 00 00 00 00 00 02 8F 02
			15 00 00 00 00 00 02 90 0D
			15 00 00 00 00 00 02 91 02
			15 00 00 00 00 00 02 92 42
			15 00 00 00 00 00 02 93 02
			15 00 00 00 00 00 02 94 44
			15 00 00 00 00 00 02 95 02
			15 00 00 00 00 00 02 96 79
			15 00 00 00 00 00 02 97 02
			15 00 00 00 00 00 02 98 B4
			15 00 00 00 00 00 02 99 02
			15 00 00 00 00 00 02 9A DA
			15 00 00 00 00 00 02 9B 03
			15 00 00 00 00 00 02 9C 0B
			15 00 00 00 00 00 02 9D 03
			15 00 00 00 00 00 02 9E 2F
			15 00 00 00 00 00 02 9F 03
			15 00 00 00 00 00 02 A0 60
			15 00 00 00 00 00 02 A2 03
			15 00 00 00 00 00 02 A3 70
			15 00 00 00 00 00 02 A4 03
			15 00 00 00 00 00 02 A5 81
			15 00 00 00 00 00 02 A6 03
			15 00 00 00 00 00 02 A7 93
			15 00 00 00 00 00 02 A9 03
			15 00 00 00 00 00 02 AA A7
			15 00 00 00 00 00 02 AB 03
			15 00 00 00 00 00 02 AC BE
			15 00 00 00 00 00 02 AD 03
			15 00 00 00 00 00 02 AE D6
			15 00 00 00 00 00 02 AF 03
			15 00 00 00 00 00 02 B0 F1
			15 00 00 00 00 00 02 B1 03
			15 01 00 00 00 00 02 B2 FF
			//R(-) MCR cmd
			15 00 00 00 00 00 02 B3 00
			15 00 00 00 00 00 02 B4 00
			15 00 00 00 00 00 02 B5 00
			15 00 00 00 00 00 02 B6 1F
			15 00 00 00 00 00 02 B7 00
			15 00 00 00 00 00 02 B8 56
			15 00 00 00 00 00 02 B9 00
			15 00 00 00 00 00 02 BA 7F
			15 00 00 00 00 00 02 BB 00
			15 00 00 00 00 00 02 BC 9E
			15 00 00 00 00 00 02 BD 00
			15 00 00 00 00 00 02 BE B8
			15 00 00 00 00 00 02 BF 00
			15 00 00 00 00 00 02 C0 CE
			15 00 00 00 00 00 02 C1 00
			15 00 00 00 00 00 02 C2 E2
			15 00 00 00 00 00 02 C3 00
			15 00 00 00 00 00 02 C4 F4
			15 00 00 00 00 00 02 C5 01
			15 00 00 00 00 00 02 C6 2D
			15 00 00 00 00 00 02 C7 01
			15 00 00 00 00 00 02 C8 58
			15 00 00 00 00 00 02 C9 01
			15 00 00 00 00 00 02 CA 97
			15 00 00 00 00 00 02 CB 01
			15 00 00 00 00 00 02 CC C7
			15 00 00 00 00 00 02 CD 02
			15 00 00 00 00 00 02 CE 0D
			15 00 00 00 00 00 02 CF 02
			15 00 00 00 00 00 02 D0 42
			15 00 00 00 00 00 02 D1 02
			15 00 00 00 00 00 02 D2 44
			15 00 00 00 00 00 02 D3 02
			15 00 00 00 00 00 02 D4 79
			15 00 00 00 00 00 02 D5 02
			15 00 00 00 00 00 02 D6 B4
			15 00 00 00 00 00 02 D7 02
			15 00 00 00 00 00 02 D8 DA
			15 00 00 00 00 00 02 D9 03
			15 00 00 00 00 00 02 DA 0B
			15 00 00 00 00 00 02 DB 03
			15 00 00 00 00 00 02 DC 2F
			15 00 00 00 00 00 02 DD 03
			15 00 00 00 00 00 02 DE 60
			15 00 00 00 00 00 02 DF 03
			15 00 00 00 00 00 02 E0 70
			15 00 00 00 00 00 02 E1 03
			15 00 00 00 00 00 02 E2 81
			15 00 00 00 00 00 02 E3 03
			15 00 00 00 00 00 02 E4 93
			15 00 00 00 00 00 02 E5 03
			15 00 00 00 00 00 02 E6 A7
			15 00 00 00 00 00 02 E7 03
			15 00 00 00 00 00 02 E8 BE
			15 00 00 00 00 00 02 E9 03
			15 00 00 00 00 00 02 EA D6
			15 00 00 00 00 00 02 EB 03
			15 00 00 00 00 00 02 EC F1
			15 00 00 00 00 00 02 ED 03
			15 01 00 00 00 00 02 EE FF
			//G(+) MCR cmd
			15 00 00 00 00 00 02 EF 00
			15 00 00 00 00 00 02 F0 CD
			15 00 00 00 00 00 02 F1 00
			15 00 00 00 00 00 02 F2 D7
			15 00 00 00 00 00 02 F3 00
			15 00 00 00 00 00 02 F4 E9
			15 00 00 00 00 00 02 F5 00
			15 00 00 00 00 00 02 F6 F8
			15 00 00 00 00 00 02 F7 01
			15 00 00 00 00 00 02 F8 07
			15 00 00 00 00 00 02 F9 01
			15 00 00 00 00 00 02 FA 15
			//page selection cmd start
			15 00 00 00 00 00 02 FB 01
			15 00 00 00 00 00 02 FF 21
			//page selection cmd end
			15 00 00 00 00 00 02 00 01
			15 00 00 00 00 00 02 01 23
			15 00 00 00 00 00 02 02 01
			15 00 00 00 00 00 02 03 2F
			15 00 00 00 00 00 02 04 01
			15 00 00 00 00 00 02 05 3A
			15 00 00 00 00 00 02 06 01
			15 00 00 00 00 00 02 07 60
			15 00 00 00 00 00 02 08 01
			15 00 00 00 00 00 02 09 7F
			15 00 00 00 00 00 02 0A 01
			15 00 00 00 00 00 02 0B B1
			15 00 00 00 00 00 02 0C 01
			15 00 00 00 00 00 02 0D D8
			15 00 00 00 00 00 02 0E 02
			15 00 00 00 00 00 02 0F 19
			15 00 00 00 00 00 02 10 02
			15 00 00 00 00 00 02 11 4C
			15 00 00 00 00 00 02 12 02
			15 00 00 00 00 00 02 13 4D
			15 00 00 00 00 00 02 14 02
			15 00 00 00 00 00 02 15 81
			15 00 00 00 00 00 02 16 02
			15 00 00 00 00 00 02 17 BA
			15 00 00 00 00 00 02 18 02
			15 00 00 00 00 00 02 19 E0
			15 00 00 00 00 00 02 1A 03
			15 00 00 00 00 00 02 1B 13
			15 00 00 00 00 00 02 1C 03
			15 00 00 00 00 00 02 1D 36
			15 00 00 00 00 00 02 1E 03
			15 00 00 00 00 00 02 1F 67
			15 00 00 00 00 00 02 20 03
			15 00 00 00 00 00 02 21 76
			15 00 00 00 00 00 02 22 03
			15 00 00 00 00 00 02 23 86
			15 00 00 00 00 00 02 24 03
			15 00 00 00 00 00 02 25 98
			15 00 00 00 00 00 02 26 03
			15 00 00 00 00 00 02 27 AC
			15 00 00 00 00 00 02 28 03
			15 00 00 00 00 00 02 29 C1
			15 00 00 00 00 00 02 2A 03
			15 00 00 00 00 00 02 2B D8
			15 00 00 00 00 00 02 2D 03
			15 00 00 00 00 00 02 2F F2
			15 00 00 00 00 00 02 30 03
			15 01 00 00 00 00 02 31 FF
			//G(-) MCR cmd
			15 00 00 00 00 00 02 32 00
			15 00 00 00 00 00 02 33 CD
			15 00 00 00 00 00 02 34 00
			15 00 00 00 00 00 02 35 D7
			15 00 00 00 00 00 02 36 00
			15 00 00 00 00 00 02 37 E9
			15 00 00 00 00 00 02 38 00
			15 00 00 00 00 00 02 39 F8
			15 00 00 00 00 00 02 3A 01
			15 00 00 00 00 00 02 3B 07
			15 00 00 00 00 00 02 3D 01
			15 00 00 00 00 00 02 3F 15
			15 00 00 00 00 00 02 40 01
			15 00 00 00 00 00 02 41 23
			15 00 00 00 00 00 02 42 01
			15 00 00 00 00 00 02 43 2F
			15 00 00 00 00 00 02 44 01
			15 00 00 00 00 00 02 45 3A
			15 00 00 00 00 00 02 46 01
			15 00 00 00 00 00 02 47 60
			15 00 00 00 00 00 02 48 01
			15 00 00 00 00 00 02 49 7F
			15 00 00 00 00 00 02 4A 01
			15 00 00 00 00 00 02 4B B1
			15 00 00 00 00 00 02 4C 01
			15 00 00 00 00 00 02 4D D8
			15 00 00 00 00 00 02 4E 02
			15 00 00 00 00 00 02 4F 19
			15 00 00 00 00 00 02 50 02
			15 00 00 00 00 00 02 51 4C
			15 00 00 00 00 00 02 52 02
			15 00 00 00 00 00 02 53 4D
			15 00 00 00 00 00 02 54 02
			15 00 00 00 00 00 02 55 81
			15 00 00 00 00 00 02 56 02
			15 00 00 00 00 00 02 58 BA
			15 00 00 00 00 00 02 59 02
			15 00 00 00 00 00 02 5A E0
			15 00 00 00 00 00 02 5B 03
			15 00 00 00 00 00 02 5C 13
			15 00 00 00 00 00 02 5D 03
			15 00 00 00 00 00 02 5E 36
			15 00 00 00 00 00 02 5F 03
			15 00 00 00 00 00 02 60 67
			15 00 00 00 00 00 02 61 03
			15 00 00 00 00 00 02 62 76
			15 00 00 00 00 00 02 63 03
			15 00 00 00 00 00 02 64 86
			15 00 00 00 00 00 02 65 03
			15 00 00 00 00 00 02 66 98
			15 00 00 00 00 00 02 67 03
			15 00 00 00 00 00 02 68 AC
			15 00 00 00 00 00 02 69 03
			15 00 00 00 00 00 02 6A C1
			15 00 00 00 00 00 02 6B 03
			15 00 00 00 00 00 02 6C D8
			15 00 00 00 00 00 02 6D 03
			15 00 00 00 00 00 02 6E F2
			15 00 00 00 00 00 02 6F 03
			15 01 00 00 00 00 02 70 FF
			//B(+) MCR cmd
			15 00 00 00 00 00 02 71 01
			15 00 00 00 00 00 02 72 54
			15 00 00 00 00 00 02 73 01
			15 00 00 00 00 00 02 74 59
			15 00 00 00 00 00 02 75 01
			15 00 00 00 00 00 02 76 62
			15 00 00 00 00 00 02 77 01
			15 00 00 00 00 00 02 78 69
			15 00 00 00 00 00 02 79 01
			15 00 00 00 00 00 02 7A 70
			15 00 00 00 00 00 02 7B 01
			15 00 00 00 00 00 02 7C 77
			15 00 00 00 00 00 02 7D 01
			15 00 00 00 00 00 02 7E 7E
			15 00 00 00 00 00 02 7F 01
			15 00 00 00 00 00 02 80 85
			15 00 00 00 00 00 02 81 01
			15 00 00 00 00 00 02 82 8C
			15 00 00 00 00 00 02 83 01
			15 00 00 00 00 00 02 84 A6
			15 00 00 00 00 00 02 85 01
			15 00 00 00 00 00 02 86 BA
			15 00 00 00 00 00 02 87 01
			15 00 00 00 00 00 02 88 DE
			15 00 00 00 00 00 02 89 01
			15 00 00 00 00 00 02 8A FC
			15 00 00 00 00 00 02 8B 02
			15 00 00 00 00 00 02 8C 31
			15 00 00 00 00 00 02 8D 02
			15 00 00 00 00 00 02 8E 5F
			15 00 00 00 00 00 02 8F 02
			15 00 00 00 00 00 02 90 60
			15 00 00 00 00 00 02 91 02
			15 00 00 00 00 00 02 92 8F
			15 00 00 00 00 00 02 93 02
			15 00 00 00 00 00 02 94 C7
			15 00 00 00 00 00 02 95 02
			15 00 00 00 00 00 02 96 EC
			15 00 00 00 00 00 02 97 03
			15 00 00 00 00 00 02 98 1B
			15 00 00 00 00 00 02 99 03
			15 00 00 00 00 00 02 9A 3A
			15 00 00 00 00 00 02 9B 03
			15 00 00 00 00 00 02 9C 67
			15 00 00 00 00 00 02 9D 03
			15 00 00 00 00 00 02 9E 75
			15 00 00 00 00 00 02 9F 03
			15 00 00 00 00 00 02 A0 84
			15 00 00 00 00 00 02 A2 03
			15 00 00 00 00 00 02 A3 96
			15 00 00 00 00 00 02 A4 03
			15 00 00 00 00 00 02 A5 A9
			15 00 00 00 00 00 02 A6 03
			15 00 00 00 00 00 02 A7 BF
			15 00 00 00 00 00 02 A9 03
			15 00 00 00 00 00 02 AA D7
			15 00 00 00 00 00 02 AB 03
			15 00 00 00 00 00 02 AC F1
			15 00 00 00 00 00 02 AD 03
			15 01 00 00 00 00 02 AE FF
			//B(-) MCR cmd
			15 00 00 00 00 00 02 AF 01
			15 00 00 00 00 00 02 B0 54
			15 00 00 00 00 00 02 B1 01
			15 00 00 00 00 00 02 B2 59
			15 00 00 00 00 00 02 B3 01
			15 00 00 00 00 00 02 B4 62
			15 00 00 00 00 00 02 B5 01
			15 00 00 00 00 00 02 B6 69
			15 00 00 00 00 00 02 B7 01
			15 00 00 00 00 00 02 B8 70
			15 00 00 00 00 00 02 B9 01
			15 00 00 00 00 00 02 BA 77
			15 00 00 00 00 00 02 BB 01
			15 00 00 00 00 00 02 BC 7E
			15 00 00 00 00 00 02 BD 01
			15 00 00 00 00 00 02 BE 85
			15 00 00 00 00 00 02 BF 01
			15 00 00 00 00 00 02 C0 8C
			15 00 00 00 00 00 02 C1 01
			15 00 00 00 00 00 02 C2 A6
			15 00 00 00 00 00 02 C3 01
			15 00 00 00 00 00 02 C4 BA
			15 00 00 00 00 00 02 C5 01
			15 00 00 00 00 00 02 C6 DE
			15 00 00 00 00 00 02 C7 01
			15 00 00 00 00 00 02 C8 FC
			15 00 00 00 00 00 02 C9 02
			15 00 00 00 00 00 02 CA 31
			15 00 00 00 00 00 02 CB 02
			15 00 00 00 00 00 02 CC 5F
			15 00 00 00 00 00 02 CD 02
			15 00 00 00 00 00 02 CE 60
			15 00 00 00 00 00 02 CF 02
			15 00 00 00 00 00 02 D0 8F
			15 00 00 00 00 00 02 D1 02
			15 00 00 00 00 00 02 D2 C7
			15 00 00 00 00 00 02 D3 02
			15 00 00 00 00 00 02 D4 EC
			15 00 00 00 00 00 02 D5 03
			15 00 00 00 00 00 02 D6 1B
			15 00 00 00 00 00 02 D7 03
			15 00 00 00 00 00 02 D8 3A
			15 00 00 00 00 00 02 D9 03
			15 00 00 00 00 00 02 DA 67
			15 00 00 00 00 00 02 DB 03
			15 00 00 00 00 00 02 DC 75
			15 00 00 00 00 00 02 DD 03
			15 00 00 00 00 00 02 DE 84
			15 00 00 00 00 00 02 DF 03
			15 00 00 00 00 00 02 E0 96
			15 00 00 00 00 00 02 E1 03
			15 00 00 00 00 00 02 E2 A9
			15 00 00 00 00 00 02 E3 03
			15 00 00 00 00 00 02 E4 BF
			15 00 00 00 00 00 02 E5 03
			15 00 00 00 00 00 02 E6 D7
			15 00 00 00 00 00 02 E7 03
			15 00 00 00 00 00 02 E8 F1
			15 00 00 00 00 00 02 E9 03
			15 00 00 00 00 00 02 EA FF
			//page selection cmd start
			15 00 00 00 00 00 02 FB 01
			15 01 00 00 00 00 02 FF 10
			//page selection cmd end
		];

		qcom,panel-reader-mode-initial-step2-command = [
			//page selection cmd start
			15 01 00 00 00 00 02 FF 20
			//R(+) MCR cmd
			15 01 00 00 00 00 02 75 00
			15 01 00 00 00 00 02 76 00
			15 01 00 00 00 00 02 77 00
			15 01 00 00 00 00 02 78 1F
			15 01 00 00 00 00 02 79 00
			15 01 00 00 00 00 02 7A 56
			15 01 00 00 00 00 02 7B 00
			15 01 00 00 00 00 02 7C 7F
			15 01 00 00 00 00 02 7D 00
			15 01 00 00 00 00 02 7E 9E
			15 01 00 00 00 00 02 7F 00
			15 01 00 00 00 00 02 80 B8
			15 01 00 00 00 00 02 81 00
			15 01 00 00 00 00 02 82 CE
			15 01 00 00 00 00 02 83 00
			15 01 00 00 00 00 02 84 E2
			15 01 00 00 00 00 02 85 00
			15 01 00 00 00 00 02 86 F4
			15 01 00 00 00 00 02 87 01
			15 01 00 00 00 00 02 88 2D
			15 01 00 00 00 00 02 89 01
			15 01 00 00 00 00 02 8A 58
			15 01 00 00 00 00 02 8B 01
			15 01 00 00 00 00 02 8C 97
			15 01 00 00 00 00 02 8D 01
			15 01 00 00 00 00 02 8E C7
			15 01 00 00 00 00 02 8F 02
			15 01 00 00 00 00 02 90 0D
			15 01 00 00 00 00 02 91 02
			15 01 00 00 00 00 02 92 42
			15 01 00 00 00 00 02 93 02
			15 01 00 00 00 00 02 94 44
			15 01 00 00 00 00 02 95 02
			15 01 00 00 00 00 02 96 79
			15 01 00 00 00 00 02 97 02
			15 01 00 00 00 00 02 98 B4
			15 01 00 00 00 00 02 99 02
			15 01 00 00 00 00 02 9A DA
			15 01 00 00 00 00 02 9B 03
			15 01 00 00 00 00 02 9C 0B
			15 01 00 00 00 00 02 9D 03
			15 01 00 00 00 00 02 9E 2F
			15 01 00 00 00 00 02 9F 03
			15 01 00 00 00 00 02 A0 60
			15 01 00 00 00 00 02 A2 03
			15 01 00 00 00 00 02 A3 70
			15 01 00 00 00 00 02 A4 03
			15 01 00 00 00 00 02 A5 81
			15 01 00 00 00 00 02 A6 03
			15 01 00 00 00 00 02 A7 93
			15 01 00 00 00 00 02 A9 03
			15 01 00 00 00 00 02 AA A7
			15 01 00 00 00 00 02 AB 03
			15 01 00 00 00 00 02 AC BE
			15 01 00 00 00 00 02 AD 03
			15 01 00 00 00 00 02 AE D6
			15 01 00 00 00 00 02 AF 03
			15 01 00 00 00 00 02 B0 F1
			15 01 00 00 00 00 02 B1 03
			15 01 00 00 00 00 02 B2 FF
			//R(-) MCR cmd
			15 01 00 00 00 00 02 B3 00
			15 01 00 00 00 00 02 B4 00
			15 01 00 00 00 00 02 B5 00
			15 01 00 00 00 00 02 B6 1F
			15 01 00 00 00 00 02 B7 00
			15 01 00 00 00 00 02 B8 56
			15 01 00 00 00 00 02 B9 00
			15 01 00 00 00 00 02 BA 7F
			15 01 00 00 00 00 02 BB 00
			15 01 00 00 00 00 02 BC 9E
			15 01 00 00 00 00 02 BD 00
			15 01 00 00 00 00 02 BE B8
			15 01 00 00 00 00 02 BF 00
			15 01 00 00 00 00 02 C0 CE
			15 01 00 00 00 00 02 C1 00
			15 01 00 00 00 00 02 C2 E2
			15 01 00 00 00 00 02 C3 00
			15 01 00 00 00 00 02 C4 F4
			15 01 00 00 00 00 02 C5 01
			15 01 00 00 00 00 02 C6 2D
			15 01 00 00 00 00 02 C7 01
			15 01 00 00 00 00 02 C8 58
			15 01 00 00 00 00 02 C9 01
			15 01 00 00 00 00 02 CA 97
			15 01 00 00 00 00 02 CB 01
			15 01 00 00 00 00 02 CC C7
			15 01 00 00 00 00 02 CD 02
			15 01 00 00 00 00 02 CE 0D
			15 01 00 00 00 00 02 CF 02
			15 01 00 00 00 00 02 D0 42
			15 01 00 00 00 00 02 D1 02
			15 01 00 00 00 00 02 D2 44
			15 01 00 00 00 00 02 D3 02
			15 01 00 00 00 00 02 D4 79
			15 01 00 00 00 00 02 D5 02
			15 01 00 00 00 00 02 D6 B4
			15 01 00 00 00 00 02 D7 02
			15 01 00 00 00 00 02 D8 DA
			15 01 00 00 00 00 02 D9 03
			15 01 00 00 00 00 02 DA 0B
			15 01 00 00 00 00 02 DB 03
			15 01 00 00 00 00 02 DC 2F
			15 01 00 00 00 00 02 DD 03
			15 01 00 00 00 00 02 DE 60
			15 01 00 00 00 00 02 DF 03
			15 01 00 00 00 00 02 E0 70
			15 01 00 00 00 00 02 E1 03
			15 01 00 00 00 00 02 E2 81
			15 01 00 00 00 00 02 E3 03
			15 01 00 00 00 00 02 E4 93
			15 01 00 00 00 00 02 E5 03
			15 01 00 00 00 00 02 E6 A7
			15 01 00 00 00 00 02 E7 03
			15 01 00 00 00 00 02 E8 BE
			15 01 00 00 00 00 02 E9 03
			15 01 00 00 00 00 02 EA D6
			15 01 00 00 00 00 02 EB 03
			15 01 00 00 00 00 02 EC F1
			15 01 00 00 00 00 02 ED 03
			15 01 00 00 00 00 02 EE FF
			//G(+) MCR cmd
			15 01 00 00 00 00 02 EF 01
			15 01 00 00 00 00 02 F0 15
			15 01 00 00 00 00 02 F1 01
			15 01 00 00 00 00 02 F2 1C
			15 01 00 00 00 00 02 F3 01
			15 01 00 00 00 00 02 F4 2A
			15 01 00 00 00 00 02 F5 01
			15 01 00 00 00 00 02 F6 35
			15 01 00 00 00 00 02 F7 01
			15 01 00 00 00 00 02 F8 3E
			15 01 00 00 00 00 02 F9 01
			15 01 00 00 00 00 02 FA 48
			//page selection cmd start
			15 01 00 00 00 00 02 FB 01
			15 01 00 00 00 00 02 FF 21
			//page selection cmd end
			15 01 00 00 00 00 02 00 01
			15 01 00 00 00 00 02 01 52
			15 01 00 00 00 00 02 02 01
			15 01 00 00 00 00 02 03 5A
			15 01 00 00 00 00 02 04 01
			15 01 00 00 00 00 02 05 62
			15 01 00 00 00 00 02 06 01
			15 01 00 00 00 00 02 07 7F
			15 01 00 00 00 00 02 08 01
			15 01 00 00 00 00 02 09 9B
			15 01 00 00 00 00 02 0A 01
			15 01 00 00 00 00 02 0B C6
			15 01 00 00 00 00 02 0C 01
			15 01 00 00 00 00 02 0D E7
			15 01 00 00 00 00 02 0E 02
			15 01 00 00 00 00 02 0F 21
			15 01 00 00 00 00 02 10 02
			15 01 00 00 00 00 02 11 53
			15 01 00 00 00 00 02 12 02
			15 01 00 00 00 00 02 13 54
			15 01 00 00 00 00 02 14 02
			15 01 00 00 00 00 02 15 86
			15 01 00 00 00 00 02 16 02
			15 01 00 00 00 00 02 17 C0
			15 01 00 00 00 00 02 18 02
			15 01 00 00 00 00 02 19 E5
			15 01 00 00 00 00 02 1A 03
			15 01 00 00 00 00 02 1B 18
			15 01 00 00 00 00 02 1C 03
			15 01 00 00 00 00 02 1D 3B
			15 01 00 00 00 00 02 1E 03
			15 01 00 00 00 00 02 1F 6B
			15 01 00 00 00 00 02 20 03
			15 01 00 00 00 00 02 21 79
			15 01 00 00 00 00 02 22 03
			15 01 00 00 00 00 02 23 89
			15 01 00 00 00 00 02 24 03
			15 01 00 00 00 00 02 25 9B
			15 01 00 00 00 00 02 26 03
			15 01 00 00 00 00 02 27 AE
			15 01 00 00 00 00 02 28 03
			15 01 00 00 00 00 02 29 C3
			15 01 00 00 00 00 02 2A 03
			15 01 00 00 00 00 02 2B DA
			15 01 00 00 00 00 02 2D 03
			15 01 00 00 00 00 02 2F F2
			15 01 00 00 00 00 02 30 03
			15 01 00 00 00 00 02 31 FF
			//G(-) MCR cmd
			15 01 00 00 00 00 02 32 01
			15 01 00 00 00 00 02 33 15
			15 01 00 00 00 00 02 34 01
			15 01 00 00 00 00 02 35 1C
			15 01 00 00 00 00 02 36 01
			15 01 00 00 00 00 02 37 2A
			15 01 00 00 00 00 02 38 01
			15 01 00 00 00 00 02 39 35
			15 01 00 00 00 00 02 3A 01
			15 01 00 00 00 00 02 3B 3E
			15 01 00 00 00 00 02 3D 01
			15 01 00 00 00 00 02 3F 48
			15 01 00 00 00 00 02 40 01
			15 01 00 00 00 00 02 41 52
			15 01 00 00 00 00 02 42 01
			15 01 00 00 00 00 02 43 5A
			15 01 00 00 00 00 02 44 01
			15 01 00 00 00 00 02 45 62
			15 01 00 00 00 00 02 46 01
			15 01 00 00 00 00 02 47 7F
			15 01 00 00 00 00 02 48 01
			15 01 00 00 00 00 02 49 9B
			15 01 00 00 00 00 02 4A 01
			15 01 00 00 00 00 02 4B C6
			15 01 00 00 00 00 02 4C 01
			15 01 00 00 00 00 02 4D E7
			15 01 00 00 00 00 02 4E 02
			15 01 00 00 00 00 02 4F 21
			15 01 00 00 00 00 02 50 02
			15 01 00 00 00 00 02 51 53
			15 01 00 00 00 00 02 52 02
			15 01 00 00 00 00 02 53 54
			15 01 00 00 00 00 02 54 02
			15 01 00 00 00 00 02 55 86
			15 01 00 00 00 00 02 56 02
			15 01 00 00 00 00 02 58 C0
			15 01 00 00 00 00 02 59 02
			15 01 00 00 00 00 02 5A E5
			15 01 00 00 00 00 02 5B 03
			15 01 00 00 00 00 02 5C 18
			15 01 00 00 00 00 02 5D 03
			15 01 00 00 00 00 02 5E 3B
			15 01 00 00 00 00 02 5F 03
			15 01 00 00 00 00 02 60 6B
			15 01 00 00 00 00 02 61 03
			15 01 00 00 00 00 02 62 79
			15 01 00 00 00 00 02 63 03
			15 01 00 00 00 00 02 64 89
			15 01 00 00 00 00 02 65 03
			15 01 00 00 00 00 02 66 9B
			15 01 00 00 00 00 02 67 03
			15 01 00 00 00 00 02 68 AE
			15 01 00 00 00 00 02 69 03
			15 01 00 00 00 00 02 6A C3
			15 01 00 00 00 00 02 6B 03
			15 01 00 00 00 00 02 6C DA
			15 01 00 00 00 00 02 6D 03
			15 01 00 00 00 00 02 6E F2
			15 01 00 00 00 00 02 6F 03
			15 01 00 00 00 00 02 70 FF
			//B(+) MCR cmd
			15 01 00 00 00 00 02 71 01
			15 01 00 00 00 00 02 72 A3
			15 01 00 00 00 00 02 73 01
			15 01 00 00 00 00 02 74 A6
			15 01 00 00 00 00 02 75 01
			15 01 00 00 00 00 02 76 AA
			15 01 00 00 00 00 02 77 01
			15 01 00 00 00 00 02 78 AF
			15 01 00 00 00 00 02 79 01
			15 01 00 00 00 00 02 7A B4
			15 01 00 00 00 00 02 7B 01
			15 01 00 00 00 00 02 7C B8
			15 01 00 00 00 00 02 7D 01
			15 01 00 00 00 00 02 7E BD
			15 01 00 00 00 00 02 7F 01
			15 01 00 00 00 00 02 80 C2
			15 01 00 00 00 00 02 81 01
			15 01 00 00 00 00 02 82 C6
			15 01 00 00 00 00 02 83 01
			15 01 00 00 00 00 02 84 D6
			15 01 00 00 00 00 02 85 01
			15 01 00 00 00 00 02 86 E4
			15 01 00 00 00 00 02 87 01
			15 01 00 00 00 00 02 88 FF
			15 01 00 00 00 00 02 89 02
			15 01 00 00 00 00 02 8A 19
			15 01 00 00 00 00 02 8B 02
			15 01 00 00 00 00 02 8C 46
			15 01 00 00 00 00 02 8D 02
			15 01 00 00 00 00 02 8E 6E
			15 01 00 00 00 00 02 8F 02
			15 01 00 00 00 00 02 90 6F
			15 01 00 00 00 00 02 91 02
			15 01 00 00 00 00 02 92 9D
			15 01 00 00 00 00 02 93 02
			15 01 00 00 00 00 02 94 D2
			15 01 00 00 00 00 02 95 02
			15 01 00 00 00 00 02 96 F8
			15 01 00 00 00 00 02 97 03
			15 01 00 00 00 00 02 98 27
			15 01 00 00 00 00 02 99 03
			15 01 00 00 00 00 02 9A 48
			15 01 00 00 00 00 02 9B 03
			15 01 00 00 00 00 02 9C 74
			15 01 00 00 00 00 02 9D 03
			15 01 00 00 00 00 02 9E 82
			15 01 00 00 00 00 02 9F 03
			15 01 00 00 00 00 02 A0 91
			15 01 00 00 00 00 02 A2 03
			15 01 00 00 00 00 02 A3 A1
			15 01 00 00 00 00 02 A4 03
			15 01 00 00 00 00 02 A5 B3
			15 01 00 00 00 00 02 A6 03
			15 01 00 00 00 00 02 A7 C7
			15 01 00 00 00 00 02 A9 03
			15 01 00 00 00 00 02 AA DC
			15 01 00 00 00 00 02 AB 03
			15 01 00 00 00 00 02 AC F3
			15 01 00 00 00 00 02 AD 03
			15 01 00 00 00 00 02 AE FF
			//B(-) MCR cmd
			15 01 00 00 00 00 02 AF 01
			15 01 00 00 00 00 02 B0 A3
			15 01 00 00 00 00 02 B1 01
			15 01 00 00 00 00 02 B2 A6
			15 01 00 00 00 00 02 B3 01
			15 01 00 00 00 00 02 B4 AA
			15 01 00 00 00 00 02 B5 01
			15 01 00 00 00 00 02 B6 AF
			15 01 00 00 00 00 02 B7 01
			15 01 00 00 00 00 02 B8 B4
			15 01 00 00 00 00 02 B9 01
			15 01 00 00 00 00 02 BA B8
			15 01 00 00 00 00 02 BB 01
			15 01 00 00 00 00 02 BC BD
			15 01 00 00 00 00 02 BD 01
			15 01 00 00 00 00 02 BE C2
			15 01 00 00 00 00 02 BF 01
			15 01 00 00 00 00 02 C0 C6
			15 01 00 00 00 00 02 C1 01
			15 01 00 00 00 00 02 C2 D6
			15 01 00 00 00 00 02 C3 01
			15 01 00 00 00 00 02 C4 E4
			15 01 00 00 00 00 02 C5 01
			15 01 00 00 00 00 02 C6 FF
			15 01 00 00 00 00 02 C7 02
			15 01 00 00 00 00 02 C8 19
			15 01 00 00 00 00 02 C9 02
			15 01 00 00 00 00 02 CA 46
			15 01 00 00 00 00 02 CB 02
			15 01 00 00 00 00 02 CC 6E
			15 01 00 00 00 00 02 CD 02
			15 01 00 00 00 00 02 CE 6F
			15 01 00 00 00 00 02 CF 02
			15 01 00 00 00 00 02 D0 9D
			15 01 00 00 00 00 02 D1 02
			15 01 00 00 00 00 02 D2 D2
			15 01 00 00 00 00 02 D3 02
			15 01 00 00 00 00 02 D4 F8
			15 01 00 00 00 00 02 D5 03
			15 01 00 00 00 00 02 D6 27
			15 01 00 00 00 00 02 D7 03
			15 01 00 00 00 00 02 D8 48
			15 01 00 00 00 00 02 D9 03
			15 01 00 00 00 00 02 DA 74
			15 01 00 00 00 00 02 DB 03
			15 01 00 00 00 00 02 DC 82
			15 01 00 00 00 00 02 DD 03
			15 01 00 00 00 00 02 DE 91
			15 01 00 00 00 00 02 DF 03
			15 01 00 00 00 00 02 E0 A1
			15 01 00 00 00 00 02 E1 03
			15 01 00 00 00 00 02 E2 B3
			15 01 00 00 00 00 02 E3 03
			15 01 00 00 00 00 02 E4 C7
			15 01 00 00 00 00 02 E5 03
			15 01 00 00 00 00 02 E6 DC
			15 01 00 00 00 00 02 E7 03
			15 01 00 00 00 00 02 E8 F3
			15 01 00 00 00 00 02 E9 03
			15 01 00 00 00 00 02 EA FF
			//page selection cmd start
			15 01 00 00 00 00 02 FB 01
			15 01 00 00 00 00 02 FF 10
			//page selection cmd end
		];

		qcom,panel-reader-mode-step2-command = [
			//page selection cmd start
			15 00 00 00 00 00 02 FF 20
			//R(+) MCR cmd
			15 00 00 00 00 00 02 75 00
			15 00 00 00 00 00 02 76 00
			15 00 00 00 00 00 02 77 00
			15 00 00 00 00 00 02 78 1F
			15 00 00 00 00 00 02 79 00
			15 00 00 00 00 00 02 7A 56
			15 00 00 00 00 00 02 7B 00
			15 00 00 00 00 00 02 7C 7F
			15 00 00 00 00 00 02 7D 00
			15 00 00 00 00 00 02 7E 9E
			15 00 00 00 00 00 02 7F 00
			15 00 00 00 00 00 02 80 B8
			15 00 00 00 00 00 02 81 00
			15 00 00 00 00 00 02 82 CE
			15 00 00 00 00 00 02 83 00
			15 00 00 00 00 00 02 84 E2
			15 00 00 00 00 00 02 85 00
			15 00 00 00 00 00 02 86 F4
			15 00 00 00 00 00 02 87 01
			15 00 00 00 00 00 02 88 2D
			15 00 00 00 00 00 02 89 01
			15 00 00 00 00 00 02 8A 58
			15 00 00 00 00 00 02 8B 01
			15 00 00 00 00 00 02 8C 97
			15 00 00 00 00 00 02 8D 01
			15 00 00 00 00 00 02 8E C7
			15 00 00 00 00 00 02 8F 02
			15 00 00 00 00 00 02 90 0D
			15 00 00 00 00 00 02 91 02
			15 00 00 00 00 00 02 92 42
			15 00 00 00 00 00 02 93 02
			15 00 00 00 00 00 02 94 44
			15 00 00 00 00 00 02 95 02
			15 00 00 00 00 00 02 96 79
			15 00 00 00 00 00 02 97 02
			15 00 00 00 00 00 02 98 B4
			15 00 00 00 00 00 02 99 02
			15 00 00 00 00 00 02 9A DA
			15 00 00 00 00 00 02 9B 03
			15 00 00 00 00 00 02 9C 0B
			15 00 00 00 00 00 02 9D 03
			15 00 00 00 00 00 02 9E 2F
			15 00 00 00 00 00 02 9F 03
			15 00 00 00 00 00 02 A0 60
			15 00 00 00 00 00 02 A2 03
			15 00 00 00 00 00 02 A3 70
			15 00 00 00 00 00 02 A4 03
			15 00 00 00 00 00 02 A5 81
			15 00 00 00 00 00 02 A6 03
			15 00 00 00 00 00 02 A7 93
			15 00 00 00 00 00 02 A9 03
			15 00 00 00 00 00 02 AA A7
			15 00 00 00 00 00 02 AB 03
			15 00 00 00 00 00 02 AC BE
			15 00 00 00 00 00 02 AD 03
			15 00 00 00 00 00 02 AE D6
			15 00 00 00 00 00 02 AF 03
			15 00 00 00 00 00 02 B0 F1
			15 00 00 00 00 00 02 B1 03
			15 01 00 00 00 00 02 B2 FF
			//R(-) MCR cmd
			15 00 00 00 00 00 02 B3 00
			15 00 00 00 00 00 02 B4 00
			15 00 00 00 00 00 02 B5 00
			15 00 00 00 00 00 02 B6 1F
			15 00 00 00 00 00 02 B7 00
			15 00 00 00 00 00 02 B8 56
			15 00 00 00 00 00 02 B9 00
			15 00 00 00 00 00 02 BA 7F
			15 00 00 00 00 00 02 BB 00
			15 00 00 00 00 00 02 BC 9E
			15 00 00 00 00 00 02 BD 00
			15 00 00 00 00 00 02 BE B8
			15 00 00 00 00 00 02 BF 00
			15 00 00 00 00 00 02 C0 CE
			15 00 00 00 00 00 02 C1 00
			15 00 00 00 00 00 02 C2 E2
			15 00 00 00 00 00 02 C3 00
			15 00 00 00 00 00 02 C4 F4
			15 00 00 00 00 00 02 C5 01
			15 00 00 00 00 00 02 C6 2D
			15 00 00 00 00 00 02 C7 01
			15 00 00 00 00 00 02 C8 58
			15 00 00 00 00 00 02 C9 01
			15 00 00 00 00 00 02 CA 97
			15 00 00 00 00 00 02 CB 01
			15 00 00 00 00 00 02 CC C7
			15 00 00 00 00 00 02 CD 02
			15 00 00 00 00 00 02 CE 0D
			15 00 00 00 00 00 02 CF 02
			15 00 00 00 00 00 02 D0 42
			15 00 00 00 00 00 02 D1 02
			15 00 00 00 00 00 02 D2 44
			15 00 00 00 00 00 02 D3 02
			15 00 00 00 00 00 02 D4 79
			15 00 00 00 00 00 02 D5 02
			15 00 00 00 00 00 02 D6 B4
			15 00 00 00 00 00 02 D7 02
			15 00 00 00 00 00 02 D8 DA
			15 00 00 00 00 00 02 D9 03
			15 00 00 00 00 00 02 DA 0B
			15 00 00 00 00 00 02 DB 03
			15 00 00 00 00 00 02 DC 2F
			15 00 00 00 00 00 02 DD 03
			15 00 00 00 00 00 02 DE 60
			15 00 00 00 00 00 02 DF 03
			15 00 00 00 00 00 02 E0 70
			15 00 00 00 00 00 02 E1 03
			15 00 00 00 00 00 02 E2 81
			15 00 00 00 00 00 02 E3 03
			15 00 00 00 00 00 02 E4 93
			15 00 00 00 00 00 02 E5 03
			15 00 00 00 00 00 02 E6 A7
			15 00 00 00 00 00 02 E7 03
			15 00 00 00 00 00 02 E8 BE
			15 00 00 00 00 00 02 E9 03
			15 00 00 00 00 00 02 EA D6
			15 00 00 00 00 00 02 EB 03
			15 00 00 00 00 00 02 EC F1
			15 00 00 00 00 00 02 ED 03
			15 01 00 00 00 00 02 EE FF
			//G(+) MCR cmd
			15 00 00 00 00 00 02 EF 01
			15 00 00 00 00 00 02 F0 15
			15 00 00 00 00 00 02 F1 01
			15 00 00 00 00 00 02 F2 1C
			15 00 00 00 00 00 02 F3 01
			15 00 00 00 00 00 02 F4 2A
			15 00 00 00 00 00 02 F5 01
			15 00 00 00 00 00 02 F6 35
			15 00 00 00 00 00 02 F7 01
			15 00 00 00 00 00 02 F8 3E
			15 00 00 00 00 00 02 F9 01
			15 00 00 00 00 00 02 FA 48
			//page selection cmd start
			15 00 00 00 00 00 02 FB 01
			15 00 00 00 00 00 02 FF 21
			//page selection cmd end
			15 00 00 00 00 00 02 00 01
			15 00 00 00 00 00 02 01 52
			15 00 00 00 00 00 02 02 01
			15 00 00 00 00 00 02 03 5A
			15 00 00 00 00 00 02 04 01
			15 00 00 00 00 00 02 05 62
			15 00 00 00 00 00 02 06 01
			15 00 00 00 00 00 02 07 7F
			15 00 00 00 00 00 02 08 01
			15 00 00 00 00 00 02 09 9B
			15 00 00 00 00 00 02 0A 01
			15 00 00 00 00 00 02 0B C6
			15 00 00 00 00 00 02 0C 01
			15 00 00 00 00 00 02 0D E7
			15 00 00 00 00 00 02 0E 02
			15 00 00 00 00 00 02 0F 21
			15 00 00 00 00 00 02 10 02
			15 00 00 00 00 00 02 11 53
			15 00 00 00 00 00 02 12 02
			15 00 00 00 00 00 02 13 54
			15 00 00 00 00 00 02 14 02
			15 00 00 00 00 00 02 15 86
			15 00 00 00 00 00 02 16 02
			15 00 00 00 00 00 02 17 C0
			15 00 00 00 00 00 02 18 02
			15 00 00 00 00 00 02 19 E5
			15 00 00 00 00 00 02 1A 03
			15 00 00 00 00 00 02 1B 18
			15 00 00 00 00 00 02 1C 03
			15 00 00 00 00 00 02 1D 3B
			15 00 00 00 00 00 02 1E 03
			15 00 00 00 00 00 02 1F 6B
			15 00 00 00 00 00 02 20 03
			15 00 00 00 00 00 02 21 79
			15 00 00 00 00 00 02 22 03
			15 00 00 00 00 00 02 23 89
			15 00 00 00 00 00 02 24 03
			15 00 00 00 00 00 02 25 9B
			15 00 00 00 00 00 02 26 03
			15 00 00 00 00 00 02 27 AE
			15 00 00 00 00 00 02 28 03
			15 00 00 00 00 00 02 29 C3
			15 00 00 00 00 00 02 2A 03
			15 00 00 00 00 00 02 2B DA
			15 00 00 00 00 00 02 2D 03
			15 00 00 00 00 00 02 2F F2
			15 00 00 00 00 00 02 30 03
			15 01 00 00 00 00 02 31 FF
			//G(-) MCR cmd
			15 00 00 00 00 00 02 32 01
			15 00 00 00 00 00 02 33 15
			15 00 00 00 00 00 02 34 01
			15 00 00 00 00 00 02 35 1C
			15 00 00 00 00 00 02 36 01
			15 00 00 00 00 00 02 37 2A
			15 00 00 00 00 00 02 38 01
			15 00 00 00 00 00 02 39 35
			15 00 00 00 00 00 02 3A 01
			15 00 00 00 00 00 02 3B 3E
			15 00 00 00 00 00 02 3D 01
			15 00 00 00 00 00 02 3F 48
			15 00 00 00 00 00 02 40 01
			15 00 00 00 00 00 02 41 52
			15 00 00 00 00 00 02 42 01
			15 00 00 00 00 00 02 43 5A
			15 00 00 00 00 00 02 44 01
			15 00 00 00 00 00 02 45 62
			15 00 00 00 00 00 02 46 01
			15 00 00 00 00 00 02 47 7F
			15 00 00 00 00 00 02 48 01
			15 00 00 00 00 00 02 49 9B
			15 00 00 00 00 00 02 4A 01
			15 00 00 00 00 00 02 4B C6
			15 00 00 00 00 00 02 4C 01
			15 00 00 00 00 00 02 4D E7
			15 00 00 00 00 00 02 4E 02
			15 00 00 00 00 00 02 4F 21
			15 00 00 00 00 00 02 50 02
			15 00 00 00 00 00 02 51 53
			15 00 00 00 00 00 02 52 02
			15 00 00 00 00 00 02 53 54
			15 00 00 00 00 00 02 54 02
			15 00 00 00 00 00 02 55 86
			15 00 00 00 00 00 02 56 02
			15 00 00 00 00 00 02 58 C0
			15 00 00 00 00 00 02 59 02
			15 00 00 00 00 00 02 5A E5
			15 00 00 00 00 00 02 5B 03
			15 00 00 00 00 00 02 5C 18
			15 00 00 00 00 00 02 5D 03
			15 00 00 00 00 00 02 5E 3B
			15 00 00 00 00 00 02 5F 03
			15 00 00 00 00 00 02 60 6B
			15 00 00 00 00 00 02 61 03
			15 00 00 00 00 00 02 62 79
			15 00 00 00 00 00 02 63 03
			15 00 00 00 00 00 02 64 89
			15 00 00 00 00 00 02 65 03
			15 00 00 00 00 00 02 66 9B
			15 00 00 00 00 00 02 67 03
			15 00 00 00 00 00 02 68 AE
			15 00 00 00 00 00 02 69 03
			15 00 00 00 00 00 02 6A C3
			15 00 00 00 00 00 02 6B 03
			15 00 00 00 00 00 02 6C DA
			15 00 00 00 00 00 02 6D 03
			15 00 00 00 00 00 02 6E F2
			15 00 00 00 00 00 02 6F 03
			15 01 00 00 00 00 02 70 FF
			//B(+) MCR cmd
			15 00 00 00 00 00 02 71 01
			15 00 00 00 00 00 02 72 A3
			15 00 00 00 00 00 02 73 01
			15 00 00 00 00 00 02 74 A6
			15 00 00 00 00 00 02 75 01
			15 00 00 00 00 00 02 76 AA
			15 00 00 00 00 00 02 77 01
			15 00 00 00 00 00 02 78 AF
			15 00 00 00 00 00 02 79 01
			15 00 00 00 00 00 02 7A B4
			15 00 00 00 00 00 02 7B 01
			15 00 00 00 00 00 02 7C B8
			15 00 00 00 00 00 02 7D 01
			15 00 00 00 00 00 02 7E BD
			15 00 00 00 00 00 02 7F 01
			15 00 00 00 00 00 02 80 C2
			15 00 00 00 00 00 02 81 01
			15 00 00 00 00 00 02 82 C6
			15 00 00 00 00 00 02 83 01
			15 00 00 00 00 00 02 84 D6
			15 00 00 00 00 00 02 85 01
			15 00 00 00 00 00 02 86 E4
			15 00 00 00 00 00 02 87 01
			15 00 00 00 00 00 02 88 FF
			15 00 00 00 00 00 02 89 02
			15 00 00 00 00 00 02 8A 19
			15 00 00 00 00 00 02 8B 02
			15 00 00 00 00 00 02 8C 46
			15 00 00 00 00 00 02 8D 02
			15 00 00 00 00 00 02 8E 6E
			15 00 00 00 00 00 02 8F 02
			15 00 00 00 00 00 02 90 6F
			15 00 00 00 00 00 02 91 02
			15 00 00 00 00 00 02 92 9D
			15 00 00 00 00 00 02 93 02
			15 00 00 00 00 00 02 94 D2
			15 00 00 00 00 00 02 95 02
			15 00 00 00 00 00 02 96 F8
			15 00 00 00 00 00 02 97 03
			15 00 00 00 00 00 02 98 27
			15 00 00 00 00 00 02 99 03
			15 00 00 00 00 00 02 9A 48
			15 00 00 00 00 00 02 9B 03
			15 00 00 00 00 00 02 9C 74
			15 00 00 00 00 00 02 9D 03
			15 00 00 00 00 00 02 9E 82
			15 00 00 00 00 00 02 9F 03
			15 00 00 00 00 00 02 A0 91
			15 00 00 00 00 00 02 A2 03
			15 00 00 00 00 00 02 A3 A1
			15 00 00 00 00 00 02 A4 03
			15 00 00 00 00 00 02 A5 B3
			15 00 00 00 00 00 02 A6 03
			15 00 00 00 00 00 02 A7 C7
			15 00 00 00 00 00 02 A9 03
			15 00 00 00 00 00 02 AA DC
			15 00 00 00 00 00 02 AB 03
			15 00 00 00 00 00 02 AC F3
			15 00 00 00 00 00 02 AD 03
			15 01 00 00 00 00 02 AE FF
			//B(-) MCR cmd
			15 00 00 00 00 00 02 AF 01
			15 00 00 00 00 00 02 B0 A3
			15 00 00 00 00 00 02 B1 01
			15 00 00 00 00 00 02 B2 A6
			15 00 00 00 00 00 02 B3 01
			15 00 00 00 00 00 02 B4 AA
			15 00 00 00 00 00 02 B5 01
			15 00 00 00 00 00 02 B6 AF
			15 00 00 00 00 00 02 B7 01
			15 00 00 00 00 00 02 B8 B4
			15 00 00 00 00 00 02 B9 01
			15 00 00 00 00 00 02 BA B8
			15 00 00 00 00 00 02 BB 01
			15 00 00 00 00 00 02 BC BD
			15 00 00 00 00 00 02 BD 01
			15 00 00 00 00 00 02 BE C2
			15 00 00 00 00 00 02 BF 01
			15 00 00 00 00 00 02 C0 C6
			15 00 00 00 00 00 02 C1 01
			15 00 00 00 00 00 02 C2 D6
			15 00 00 00 00 00 02 C3 01
			15 00 00 00 00 00 02 C4 E4
			15 00 00 00 00 00 02 C5 01
			15 00 00 00 00 00 02 C6 FF
			15 00 00 00 00 00 02 C7 02
			15 00 00 00 00 00 02 C8 19
			15 00 00 00 00 00 02 C9 02
			15 00 00 00 00 00 02 CA 46
			15 00 00 00 00 00 02 CB 02
			15 00 00 00 00 00 02 CC 6E
			15 00 00 00 00 00 02 CD 02
			15 00 00 00 00 00 02 CE 6F
			15 00 00 00 00 00 02 CF 02
			15 00 00 00 00 00 02 D0 9D
			15 00 00 00 00 00 02 D1 02
			15 00 00 00 00 00 02 D2 D2
			15 00 00 00 00 00 02 D3 02
			15 00 00 00 00 00 02 D4 F8
			15 00 00 00 00 00 02 D5 03
			15 00 00 00 00 00 02 D6 27
			15 00 00 00 00 00 02 D7 03
			15 00 00 00 00 00 02 D8 48
			15 00 00 00 00 00 02 D9 03
			15 00 00 00 00 00 02 DA 74
			15 00 00 00 00 00 02 DB 03
			15 00 00 00 00 00 02 DC 82
			15 00 00 00 00 00 02 DD 03
			15 00 00 00 00 00 02 DE 91
			15 00 00 00 00 00 02 DF 03
			15 00 00 00 00 00 02 E0 A1
			15 00 00 00 00 00 02 E1 03
			15 00 00 00 00 00 02 E2 B3
			15 00 00 00 00 00 02 E3 03
			15 00 00 00 00 00 02 E4 C7
			15 00 00 00 00 00 02 E5 03
			15 00 00 00 00 00 02 E6 DC
			15 00 00 00 00 00 02 E7 03
			15 00 00 00 00 00 02 E8 F3
			15 00 00 00 00 00 02 E9 03
			15 00 00 00 00 00 02 EA FF
			//page selection cmd start
			15 00 00 00 00 00 02 FB 01
			15 01 00 00 00 00 02 FF 10
			//page selection cmd end
		];

		qcom,panel-reader-mode-initial-step3-command = [
			//page selection cmd start
			15 01 00 00 00 00 02 FF 20
			//R(+) MCR cmd
			15 01 00 00 00 00 02 75 00
			15 01 00 00 00 00 02 76 00
			15 01 00 00 00 00 02 77 00
			15 01 00 00 00 00 02 78 1F
			15 01 00 00 00 00 02 79 00
			15 01 00 00 00 00 02 7A 56
			15 01 00 00 00 00 02 7B 00
			15 01 00 00 00 00 02 7C 7F
			15 01 00 00 00 00 02 7D 00
			15 01 00 00 00 00 02 7E 9E
			15 01 00 00 00 00 02 7F 00
			15 01 00 00 00 00 02 80 B8
			15 01 00 00 00 00 02 81 00
			15 01 00 00 00 00 02 82 CE
			15 01 00 00 00 00 02 83 00
			15 01 00 00 00 00 02 84 E2
			15 01 00 00 00 00 02 85 00
			15 01 00 00 00 00 02 86 F4
			15 01 00 00 00 00 02 87 01
			15 01 00 00 00 00 02 88 2D
			15 01 00 00 00 00 02 89 01
			15 01 00 00 00 00 02 8A 58
			15 01 00 00 00 00 02 8B 01
			15 01 00 00 00 00 02 8C 97
			15 01 00 00 00 00 02 8D 01
			15 01 00 00 00 00 02 8E C7
			15 01 00 00 00 00 02 8F 02
			15 01 00 00 00 00 02 90 0D
			15 01 00 00 00 00 02 91 02
			15 01 00 00 00 00 02 92 42
			15 01 00 00 00 00 02 93 02
			15 01 00 00 00 00 02 94 44
			15 01 00 00 00 00 02 95 02
			15 01 00 00 00 00 02 96 79
			15 01 00 00 00 00 02 97 02
			15 01 00 00 00 00 02 98 B4
			15 01 00 00 00 00 02 99 02
			15 01 00 00 00 00 02 9A DA
			15 01 00 00 00 00 02 9B 03
			15 01 00 00 00 00 02 9C 0B
			15 01 00 00 00 00 02 9D 03
			15 01 00 00 00 00 02 9E 2F
			15 01 00 00 00 00 02 9F 03
			15 01 00 00 00 00 02 A0 60
			15 01 00 00 00 00 02 A2 03
			15 01 00 00 00 00 02 A3 70
			15 01 00 00 00 00 02 A4 03
			15 01 00 00 00 00 02 A5 81
			15 01 00 00 00 00 02 A6 03
			15 01 00 00 00 00 02 A7 93
			15 01 00 00 00 00 02 A9 03
			15 01 00 00 00 00 02 AA A7
			15 01 00 00 00 00 02 AB 03
			15 01 00 00 00 00 02 AC BE
			15 01 00 00 00 00 02 AD 03
			15 01 00 00 00 00 02 AE D6
			15 01 00 00 00 00 02 AF 03
			15 01 00 00 00 00 02 B0 F1
			15 01 00 00 00 00 02 B1 03
			15 01 00 00 00 00 02 B2 FF
			//R(-) MCR cmd
			15 01 00 00 00 00 02 B3 00
			15 01 00 00 00 00 02 B4 00
			15 01 00 00 00 00 02 B5 00
			15 01 00 00 00 00 02 B6 1F
			15 01 00 00 00 00 02 B7 00
			15 01 00 00 00 00 02 B8 56
			15 01 00 00 00 00 02 B9 00
			15 01 00 00 00 00 02 BA 7F
			15 01 00 00 00 00 02 BB 00
			15 01 00 00 00 00 02 BC 9E
			15 01 00 00 00 00 02 BD 00
			15 01 00 00 00 00 02 BE B8
			15 01 00 00 00 00 02 BF 00
			15 01 00 00 00 00 02 C0 CE
			15 01 00 00 00 00 02 C1 00
			15 01 00 00 00 00 02 C2 E2
			15 01 00 00 00 00 02 C3 00
			15 01 00 00 00 00 02 C4 F4
			15 01 00 00 00 00 02 C5 01
			15 01 00 00 00 00 02 C6 2D
			15 01 00 00 00 00 02 C7 01
			15 01 00 00 00 00 02 C8 58
			15 01 00 00 00 00 02 C9 01
			15 01 00 00 00 00 02 CA 97
			15 01 00 00 00 00 02 CB 01
			15 01 00 00 00 00 02 CC C7
			15 01 00 00 00 00 02 CD 02
			15 01 00 00 00 00 02 CE 0D
			15 01 00 00 00 00 02 CF 02
			15 01 00 00 00 00 02 D0 42
			15 01 00 00 00 00 02 D1 02
			15 01 00 00 00 00 02 D2 44
			15 01 00 00 00 00 02 D3 02
			15 01 00 00 00 00 02 D4 79
			15 01 00 00 00 00 02 D5 02
			15 01 00 00 00 00 02 D6 B4
			15 01 00 00 00 00 02 D7 02
			15 01 00 00 00 00 02 D8 DA
			15 01 00 00 00 00 02 D9 03
			15 01 00 00 00 00 02 DA 0B
			15 01 00 00 00 00 02 DB 03
			15 01 00 00 00 00 02 DC 2F
			15 01 00 00 00 00 02 DD 03
			15 01 00 00 00 00 02 DE 60
			15 01 00 00 00 00 02 DF 03
			15 01 00 00 00 00 02 E0 70
			15 01 00 00 00 00 02 E1 03
			15 01 00 00 00 00 02 E2 81
			15 01 00 00 00 00 02 E3 03
			15 01 00 00 00 00 02 E4 93
			15 01 00 00 00 00 02 E5 03
			15 01 00 00 00 00 02 E6 A7
			15 01 00 00 00 00 02 E7 03
			15 01 00 00 00 00 02 E8 BE
			15 01 00 00 00 00 02 E9 03
			15 01 00 00 00 00 02 EA D6
			15 01 00 00 00 00 02 EB 03
			15 01 00 00 00 00 02 EC F1
			15 01 00 00 00 00 02 ED 03
			15 01 00 00 00 00 02 EE FF
			//G(+) MCR cmd
			15 01 00 00 00 00 02 EF 01
			15 01 00 00 00 00 02 F0 46
			15 01 00 00 00 00 02 F1 01
			15 01 00 00 00 00 02 F2 4B
			15 01 00 00 00 00 02 F3 01
			15 01 00 00 00 00 02 F4 54
			15 01 00 00 00 00 02 F5 01
			15 01 00 00 00 00 02 F6 5C
			15 01 00 00 00 00 02 F7 01
			15 01 00 00 00 00 02 F8 64
			15 01 00 00 00 00 02 F9 01
			15 01 00 00 00 00 02 FA 6B
			//page selection cmd start
			15 01 00 00 00 00 02 FB 01
			15 01 00 00 00 00 02 FF 21
			//page selection cmd end
			15 01 00 00 00 00 02 00 01
			15 01 00 00 00 00 02 01 72
			15 01 00 00 00 00 02 02 01
			15 01 00 00 00 00 02 03 79
			15 01 00 00 00 00 02 04 01
			15 01 00 00 00 00 02 05 80
			15 01 00 00 00 00 02 06 01
			15 01 00 00 00 00 02 07 9B
			15 01 00 00 00 00 02 08 01
			15 01 00 00 00 00 02 09 AF
			15 01 00 00 00 00 02 0A 01
			15 01 00 00 00 00 02 0B D4
			15 01 00 00 00 00 02 0C 01
			15 01 00 00 00 00 02 0D F3
			15 01 00 00 00 00 02 0E 02
			15 01 00 00 00 00 02 0F 2A
			15 01 00 00 00 00 02 10 02
			15 01 00 00 00 00 02 11 59
			15 01 00 00 00 00 02 12 02
			15 01 00 00 00 00 02 13 5B
			15 01 00 00 00 00 02 14 02
			15 01 00 00 00 00 02 15 8C
			15 01 00 00 00 00 02 16 02
			15 01 00 00 00 00 02 17 C4
			15 01 00 00 00 00 02 18 02
			15 01 00 00 00 00 02 19 EA
			15 01 00 00 00 00 02 1A 03
			15 01 00 00 00 00 02 1B 1C
			15 01 00 00 00 00 02 1C 03
			15 01 00 00 00 00 02 1D 3E
			15 01 00 00 00 00 02 1E 03
			15 01 00 00 00 00 02 1F 6D
			15 01 00 00 00 00 02 20 03
			15 01 00 00 00 00 02 21 7B
			15 01 00 00 00 00 02 22 03
			15 01 00 00 00 00 02 23 8B
			15 01 00 00 00 00 02 24 03
			15 01 00 00 00 00 02 25 9D
			15 01 00 00 00 00 02 26 03
			15 01 00 00 00 00 02 27 AF
			15 01 00 00 00 00 02 28 03
			15 01 00 00 00 00 02 29 C4
			15 01 00 00 00 00 02 2A 03
			15 01 00 00 00 00 02 2B DA
			15 01 00 00 00 00 02 2D 03
			15 01 00 00 00 00 02 2F F3
			15 01 00 00 00 00 02 30 03
			15 01 00 00 00 00 02 31 FF
			//G(-) MCR cmd
			15 01 00 00 00 00 02 32 01
			15 01 00 00 00 00 02 33 46
			15 01 00 00 00 00 02 34 01
			15 01 00 00 00 00 02 35 4B
			15 01 00 00 00 00 02 36 01
			15 01 00 00 00 00 02 37 54
			15 01 00 00 00 00 02 38 01
			15 01 00 00 00 00 02 39 5C
			15 01 00 00 00 00 02 3A 01
			15 01 00 00 00 00 02 3B 64
			15 01 00 00 00 00 02 3D 01
			15 01 00 00 00 00 02 3F 6B
			15 01 00 00 00 00 02 40 01
			15 01 00 00 00 00 02 41 72
			15 01 00 00 00 00 02 42 01
			15 01 00 00 00 00 02 43 79
			15 01 00 00 00 00 02 44 01
			15 01 00 00 00 00 02 45 80
			15 01 00 00 00 00 02 46 01
			15 01 00 00 00 00 02 47 9B
			15 01 00 00 00 00 02 48 01
			15 01 00 00 00 00 02 49 AF
			15 01 00 00 00 00 02 4A 01
			15 01 00 00 00 00 02 4B D4
			15 01 00 00 00 00 02 4C 01
			15 01 00 00 00 00 02 4D F3
			15 01 00 00 00 00 02 4E 02
			15 01 00 00 00 00 02 4F 2A
			15 01 00 00 00 00 02 50 02
			15 01 00 00 00 00 02 51 59
			15 01 00 00 00 00 02 52 02
			15 01 00 00 00 00 02 53 5B
			15 01 00 00 00 00 02 54 02
			15 01 00 00 00 00 02 55 8C
			15 01 00 00 00 00 02 56 02
			15 01 00 00 00 00 02 58 C4
			15 01 00 00 00 00 02 59 02
			15 01 00 00 00 00 02 5A EA
			15 01 00 00 00 00 02 5B 03
			15 01 00 00 00 00 02 5C 1C
			15 01 00 00 00 00 02 5D 03
			15 01 00 00 00 00 02 5E 3E
			15 01 00 00 00 00 02 5F 03
			15 01 00 00 00 00 02 60 6D
			15 01 00 00 00 00 02 61 03
			15 01 00 00 00 00 02 62 7B
			15 01 00 00 00 00 02 63 03
			15 01 00 00 00 00 02 64 8B
			15 01 00 00 00 00 02 65 03
			15 01 00 00 00 00 02 66 9D
			15 01 00 00 00 00 02 67 03
			15 01 00 00 00 00 02 68 AF
			15 01 00 00 00 00 02 69 03
			15 01 00 00 00 00 02 6A C4
			15 01 00 00 00 00 02 6B 03
			15 01 00 00 00 00 02 6C DA
			15 01 00 00 00 00 02 6D 03
			15 01 00 00 00 00 02 6E F3
			15 01 00 00 00 00 02 6F 03
			15 01 00 00 00 00 02 70 FF
			//B(+) MCR cmd
			15 01 00 00 00 00 02 71 01
			15 01 00 00 00 00 02 72 CD
			15 01 00 00 00 00 02 73 01
			15 01 00 00 00 00 02 74 CF
			15 01 00 00 00 00 02 75 01
			15 01 00 00 00 00 02 76 D2
			15 01 00 00 00 00 02 77 01
			15 01 00 00 00 00 02 78 D6
			15 01 00 00 00 00 02 79 01
			15 01 00 00 00 00 02 7A D9
			15 01 00 00 00 00 02 7B 01
			15 01 00 00 00 00 02 7C DC
			15 01 00 00 00 00 02 7D 01
			15 01 00 00 00 00 02 7E DF
			15 01 00 00 00 00 02 7F 01
			15 01 00 00 00 00 02 80 E2
			15 01 00 00 00 00 02 81 01
			15 01 00 00 00 00 02 82 E6
			15 01 00 00 00 00 02 83 01
			15 01 00 00 00 00 02 84 F2
			15 01 00 00 00 00 02 85 01
			15 01 00 00 00 00 02 86 FF
			15 01 00 00 00 00 02 87 02
			15 01 00 00 00 00 02 88 17
			15 01 00 00 00 00 02 89 02
			15 01 00 00 00 00 02 8A 2C
			15 01 00 00 00 00 02 8B 02
			15 01 00 00 00 00 02 8C 54
			15 01 00 00 00 00 02 8D 02
			15 01 00 00 00 00 02 8E 79
			15 01 00 00 00 00 02 8F 02
			15 01 00 00 00 00 02 90 7A
			15 01 00 00 00 00 02 91 02
			15 01 00 00 00 00 02 92 A7
			15 01 00 00 00 00 02 93 02
			15 01 00 00 00 00 02 94 DB
			15 01 00 00 00 00 02 95 03
			15 01 00 00 00 00 02 96 00
			15 01 00 00 00 00 02 97 03
			15 01 00 00 00 00 02 98 30
			15 01 00 00 00 00 02 99 03
			15 01 00 00 00 00 02 9A 53
			15 01 00 00 00 00 02 9B 03
			15 01 00 00 00 00 02 9C 81
			15 01 00 00 00 00 02 9D 03
			15 01 00 00 00 00 02 9E 8E
			15 01 00 00 00 00 02 9F 03
			15 01 00 00 00 00 02 A0 9D
			15 01 00 00 00 00 02 A2 03
			15 01 00 00 00 00 02 A3 AC
			15 01 00 00 00 00 02 A4 03
			15 01 00 00 00 00 02 A5 BC
			15 01 00 00 00 00 02 A6 03
			15 01 00 00 00 00 02 A7 CE
			15 01 00 00 00 00 02 A9 03
			15 01 00 00 00 00 02 AA E1
			15 01 00 00 00 00 02 AB 03
			15 01 00 00 00 00 02 AC F5
			15 01 00 00 00 00 02 AD 03
			15 01 00 00 00 00 02 AE FF
			//B(-) MCR cmd
			15 01 00 00 00 00 02 AF 01
			15 01 00 00 00 00 02 B0 CD
			15 01 00 00 00 00 02 B1 01
			15 01 00 00 00 00 02 B2 CF
			15 01 00 00 00 00 02 B3 01
			15 01 00 00 00 00 02 B4 D2
			15 01 00 00 00 00 02 B5 01
			15 01 00 00 00 00 02 B6 D6
			15 01 00 00 00 00 02 B7 01
			15 01 00 00 00 00 02 B8 D9
			15 01 00 00 00 00 02 B9 01
			15 01 00 00 00 00 02 BA DC
			15 01 00 00 00 00 02 BB 01
			15 01 00 00 00 00 02 BC DF
			15 01 00 00 00 00 02 BD 01
			15 01 00 00 00 00 02 BE E2
			15 01 00 00 00 00 02 BF 01
			15 01 00 00 00 00 02 C0 E6
			15 01 00 00 00 00 02 C1 01
			15 01 00 00 00 00 02 C2 F2
			15 01 00 00 00 00 02 C3 01
			15 01 00 00 00 00 02 C4 FF
			15 01 00 00 00 00 02 C5 02
			15 01 00 00 00 00 02 C6 17
			15 01 00 00 00 00 02 C7 02
			15 01 00 00 00 00 02 C8 2C
			15 01 00 00 00 00 02 C9 02
			15 01 00 00 00 00 02 CA 54
			15 01 00 00 00 00 02 CB 02
			15 01 00 00 00 00 02 CC 79
			15 01 00 00 00 00 02 CD 02
			15 01 00 00 00 00 02 CE 7A
			15 01 00 00 00 00 02 CF 02
			15 01 00 00 00 00 02 D0 A7
			15 01 00 00 00 00 02 D1 02
			15 01 00 00 00 00 02 D2 DB
			15 01 00 00 00 00 02 D3 03
			15 01 00 00 00 00 02 D4 00
			15 01 00 00 00 00 02 D5 03
			15 01 00 00 00 00 02 D6 30
			15 01 00 00 00 00 02 D7 03
			15 01 00 00 00 00 02 D8 53
			15 01 00 00 00 00 02 D9 03
			15 01 00 00 00 00 02 DA 81
			15 01 00 00 00 00 02 DB 03
			15 01 00 00 00 00 02 DC 8E
			15 01 00 00 00 00 02 DD 03
			15 01 00 00 00 00 02 DE 9D
			15 01 00 00 00 00 02 DF 03
			15 01 00 00 00 00 02 E0 AC
			15 01 00 00 00 00 02 E1 03
			15 01 00 00 00 00 02 E2 BC
			15 01 00 00 00 00 02 E3 03
			15 01 00 00 00 00 02 E4 CE
			15 01 00 00 00 00 02 E5 03
			15 01 00 00 00 00 02 E6 E1
			15 01 00 00 00 00 02 E7 03
			15 01 00 00 00 00 02 E8 F5
			15 01 00 00 00 00 02 E9 03
			15 01 00 00 00 00 02 EA FF
			//page selection cmd start
			15 01 00 00 00 00 02 FB 01
			15 01 00 00 00 00 02 FF 10
			//page selection cmd end
		];
		qcom,panel-reader-mode-step3-command = [
			//page selection cmd start
			15 00 00 00 00 00 02 FF 20
			//R(+) MCR cmd
			15 00 00 00 00 00 02 75 00
			15 00 00 00 00 00 02 76 00
			15 00 00 00 00 00 02 77 00
			15 00 00 00 00 00 02 78 1F
			15 00 00 00 00 00 02 79 00
			15 00 00 00 00 00 02 7A 56
			15 00 00 00 00 00 02 7B 00
			15 00 00 00 00 00 02 7C 7F
			15 00 00 00 00 00 02 7D 00
			15 00 00 00 00 00 02 7E 9E
			15 00 00 00 00 00 02 7F 00
			15 00 00 00 00 00 02 80 B8
			15 00 00 00 00 00 02 81 00
			15 00 00 00 00 00 02 82 CE
			15 00 00 00 00 00 02 83 00
			15 00 00 00 00 00 02 84 E2
			15 00 00 00 00 00 02 85 00
			15 00 00 00 00 00 02 86 F4
			15 00 00 00 00 00 02 87 01
			15 00 00 00 00 00 02 88 2D
			15 00 00 00 00 00 02 89 01
			15 00 00 00 00 00 02 8A 58
			15 00 00 00 00 00 02 8B 01
			15 00 00 00 00 00 02 8C 97
			15 00 00 00 00 00 02 8D 01
			15 00 00 00 00 00 02 8E C7
			15 00 00 00 00 00 02 8F 02
			15 00 00 00 00 00 02 90 0D
			15 00 00 00 00 00 02 91 02
			15 00 00 00 00 00 02 92 42
			15 00 00 00 00 00 02 93 02
			15 00 00 00 00 00 02 94 44
			15 00 00 00 00 00 02 95 02
			15 00 00 00 00 00 02 96 79
			15 00 00 00 00 00 02 97 02
			15 00 00 00 00 00 02 98 B4
			15 00 00 00 00 00 02 99 02
			15 00 00 00 00 00 02 9A DA
			15 00 00 00 00 00 02 9B 03
			15 00 00 00 00 00 02 9C 0B
			15 00 00 00 00 00 02 9D 03
			15 00 00 00 00 00 02 9E 2F
			15 00 00 00 00 00 02 9F 03
			15 00 00 00 00 00 02 A0 60
			15 00 00 00 00 00 02 A2 03
			15 00 00 00 00 00 02 A3 70
			15 00 00 00 00 00 02 A4 03
			15 00 00 00 00 00 02 A5 81
			15 00 00 00 00 00 02 A6 03
			15 00 00 00 00 00 02 A7 93
			15 00 00 00 00 00 02 A9 03
			15 00 00 00 00 00 02 AA A7
			15 00 00 00 00 00 02 AB 03
			15 00 00 00 00 00 02 AC BE
			15 00 00 00 00 00 02 AD 03
			15 00 00 00 00 00 02 AE D6
			15 00 00 00 00 00 02 AF 03
			15 00 00 00 00 00 02 B0 F1
			15 00 00 00 00 00 02 B1 03
			15 01 00 00 00 00 02 B2 FF
			//R(-) MCR cmd
			15 00 00 00 00 00 02 B3 00
			15 00 00 00 00 00 02 B4 00
			15 00 00 00 00 00 02 B5 00
			15 00 00 00 00 00 02 B6 1F
			15 00 00 00 00 00 02 B7 00
			15 00 00 00 00 00 02 B8 56
			15 00 00 00 00 00 02 B9 00
			15 00 00 00 00 00 02 BA 7F
			15 00 00 00 00 00 02 BB 00
			15 00 00 00 00 00 02 BC 9E
			15 00 00 00 00 00 02 BD 00
			15 00 00 00 00 00 02 BE B8
			15 00 00 00 00 00 02 BF 00
			15 00 00 00 00 00 02 C0 CE
			15 00 00 00 00 00 02 C1 00
			15 00 00 00 00 00 02 C2 E2
			15 00 00 00 00 00 02 C3 00
			15 00 00 00 00 00 02 C4 F4
			15 00 00 00 00 00 02 C5 01
			15 00 00 00 00 00 02 C6 2D
			15 00 00 00 00 00 02 C7 01
			15 00 00 00 00 00 02 C8 58
			15 00 00 00 00 00 02 C9 01
			15 00 00 00 00 00 02 CA 97
			15 00 00 00 00 00 02 CB 01
			15 00 00 00 00 00 02 CC C7
			15 00 00 00 00 00 02 CD 02
			15 00 00 00 00 00 02 CE 0D
			15 00 00 00 00 00 02 CF 02
			15 00 00 00 00 00 02 D0 42
			15 00 00 00 00 00 02 D1 02
			15 00 00 00 00 00 02 D2 44
			15 00 00 00 00 00 02 D3 02
			15 00 00 00 00 00 02 D4 79
			15 00 00 00 00 00 02 D5 02
			15 00 00 00 00 00 02 D6 B4
			15 00 00 00 00 00 02 D7 02
			15 00 00 00 00 00 02 D8 DA
			15 00 00 00 00 00 02 D9 03
			15 00 00 00 00 00 02 DA 0B
			15 00 00 00 00 00 02 DB 03
			15 00 00 00 00 00 02 DC 2F
			15 00 00 00 00 00 02 DD 03
			15 00 00 00 00 00 02 DE 60
			15 00 00 00 00 00 02 DF 03
			15 00 00 00 00 00 02 E0 70
			15 00 00 00 00 00 02 E1 03
			15 00 00 00 00 00 02 E2 81
			15 00 00 00 00 00 02 E3 03
			15 00 00 00 00 00 02 E4 93
			15 00 00 00 00 00 02 E5 03
			15 00 00 00 00 00 02 E6 A7
			15 00 00 00 00 00 02 E7 03
			15 00 00 00 00 00 02 E8 BE
			15 00 00 00 00 00 02 E9 03
			15 00 00 00 00 00 02 EA D6
			15 00 00 00 00 00 02 EB 03
			15 00 00 00 00 00 02 EC F1
			15 00 00 00 00 00 02 ED 03
			15 01 00 00 00 00 02 EE FF
			//G(+) MCR cmd
			15 00 00 00 00 00 02 EF 01
			15 00 00 00 00 00 02 F0 46
			15 00 00 00 00 00 02 F1 01
			15 00 00 00 00 00 02 F2 4B
			15 00 00 00 00 00 02 F3 01
			15 00 00 00 00 00 02 F4 54
			15 00 00 00 00 00 02 F5 01
			15 00 00 00 00 00 02 F6 5C
			15 00 00 00 00 00 02 F7 01
			15 00 00 00 00 00 02 F8 64
			15 00 00 00 00 00 02 F9 01
			15 00 00 00 00 00 02 FA 6B
			//page selection cmd start
			15 00 00 00 00 00 02 FB 01
			15 00 00 00 00 00 02 FF 21
			//page selection cmd end
			15 00 00 00 00 00 02 00 01
			15 00 00 00 00 00 02 01 72
			15 00 00 00 00 00 02 02 01
			15 00 00 00 00 00 02 03 79
			15 00 00 00 00 00 02 04 01
			15 00 00 00 00 00 02 05 80
			15 00 00 00 00 00 02 06 01
			15 00 00 00 00 00 02 07 9B
			15 00 00 00 00 00 02 08 01
			15 00 00 00 00 00 02 09 AF
			15 00 00 00 00 00 02 0A 01
			15 00 00 00 00 00 02 0B D4
			15 00 00 00 00 00 02 0C 01
			15 00 00 00 00 00 02 0D F3
			15 00 00 00 00 00 02 0E 02
			15 00 00 00 00 00 02 0F 2A
			15 00 00 00 00 00 02 10 02
			15 00 00 00 00 00 02 11 59
			15 00 00 00 00 00 02 12 02
			15 00 00 00 00 00 02 13 5B
			15 00 00 00 00 00 02 14 02
			15 00 00 00 00 00 02 15 8C
			15 00 00 00 00 00 02 16 02
			15 00 00 00 00 00 02 17 C4
			15 00 00 00 00 00 02 18 02
			15 00 00 00 00 00 02 19 EA
			15 00 00 00 00 00 02 1A 03
			15 00 00 00 00 00 02 1B 1C
			15 00 00 00 00 00 02 1C 03
			15 00 00 00 00 00 02 1D 3E
			15 00 00 00 00 00 02 1E 03
			15 00 00 00 00 00 02 1F 6D
			15 00 00 00 00 00 02 20 03
			15 00 00 00 00 00 02 21 7B
			15 00 00 00 00 00 02 22 03
			15 00 00 00 00 00 02 23 8B
			15 00 00 00 00 00 02 24 03
			15 00 00 00 00 00 02 25 9D
			15 00 00 00 00 00 02 26 03
			15 00 00 00 00 00 02 27 AF
			15 00 00 00 00 00 02 28 03
			15 00 00 00 00 00 02 29 C4
			15 00 00 00 00 00 02 2A 03
			15 00 00 00 00 00 02 2B DA
			15 00 00 00 00 00 02 2D 03
			15 00 00 00 00 00 02 2F F3
			15 00 00 00 00 00 02 30 03
			15 01 00 00 00 00 02 31 FF
			//G(-) MCR cmd
			15 00 00 00 00 00 02 32 01
			15 00 00 00 00 00 02 33 46
			15 00 00 00 00 00 02 34 01
			15 00 00 00 00 00 02 35 4B
			15 00 00 00 00 00 02 36 01
			15 00 00 00 00 00 02 37 54
			15 00 00 00 00 00 02 38 01
			15 00 00 00 00 00 02 39 5C
			15 00 00 00 00 00 02 3A 01
			15 00 00 00 00 00 02 3B 64
			15 00 00 00 00 00 02 3D 01
			15 00 00 00 00 00 02 3F 6B
			15 00 00 00 00 00 02 40 01
			15 00 00 00 00 00 02 41 72
			15 00 00 00 00 00 02 42 01
			15 00 00 00 00 00 02 43 79
			15 00 00 00 00 00 02 44 01
			15 00 00 00 00 00 02 45 80
			15 00 00 00 00 00 02 46 01
			15 00 00 00 00 00 02 47 9B
			15 00 00 00 00 00 02 48 01
			15 00 00 00 00 00 02 49 AF
			15 00 00 00 00 00 02 4A 01
			15 00 00 00 00 00 02 4B D4
			15 00 00 00 00 00 02 4C 01
			15 00 00 00 00 00 02 4D F3
			15 00 00 00 00 00 02 4E 02
			15 00 00 00 00 00 02 4F 2A
			15 00 00 00 00 00 02 50 02
			15 00 00 00 00 00 02 51 59
			15 00 00 00 00 00 02 52 02
			15 00 00 00 00 00 02 53 5B
			15 00 00 00 00 00 02 54 02
			15 00 00 00 00 00 02 55 8C
			15 00 00 00 00 00 02 56 02
			15 00 00 00 00 00 02 58 C4
			15 00 00 00 00 00 02 59 02
			15 00 00 00 00 00 02 5A EA
			15 00 00 00 00 00 02 5B 03
			15 00 00 00 00 00 02 5C 1C
			15 00 00 00 00 00 02 5D 03
			15 00 00 00 00 00 02 5E 3E
			15 00 00 00 00 00 02 5F 03
			15 00 00 00 00 00 02 60 6D
			15 00 00 00 00 00 02 61 03
			15 00 00 00 00 00 02 62 7B
			15 00 00 00 00 00 02 63 03
			15 00 00 00 00 00 02 64 8B
			15 00 00 00 00 00 02 65 03
			15 00 00 00 00 00 02 66 9D
			15 00 00 00 00 00 02 67 03
			15 00 00 00 00 00 02 68 AF
			15 00 00 00 00 00 02 69 03
			15 00 00 00 00 00 02 6A C4
			15 00 00 00 00 00 02 6B 03
			15 00 00 00 00 00 02 6C DA
			15 00 00 00 00 00 02 6D 03
			15 00 00 00 00 00 02 6E F3
			15 00 00 00 00 00 02 6F 03
			15 01 00 00 00 00 02 70 FF
			//B(+) MCR cmd
			15 00 00 00 00 00 02 71 01
			15 00 00 00 00 00 02 72 CD
			15 00 00 00 00 00 02 73 01
			15 00 00 00 00 00 02 74 CF
			15 00 00 00 00 00 02 75 01
			15 00 00 00 00 00 02 76 D2
			15 00 00 00 00 00 02 77 01
			15 00 00 00 00 00 02 78 D6
			15 00 00 00 00 00 02 79 01
			15 00 00 00 00 00 02 7A D9
			15 00 00 00 00 00 02 7B 01
			15 00 00 00 00 00 02 7C DC
			15 00 00 00 00 00 02 7D 01
			15 00 00 00 00 00 02 7E DF
			15 00 00 00 00 00 02 7F 01
			15 00 00 00 00 00 02 80 E2
			15 00 00 00 00 00 02 81 01
			15 00 00 00 00 00 02 82 E6
			15 00 00 00 00 00 02 83 01
			15 00 00 00 00 00 02 84 F2
			15 00 00 00 00 00 02 85 01
			15 00 00 00 00 00 02 86 FF
			15 00 00 00 00 00 02 87 02
			15 00 00 00 00 00 02 88 17
			15 00 00 00 00 00 02 89 02
			15 00 00 00 00 00 02 8A 2C
			15 00 00 00 00 00 02 8B 02
			15 00 00 00 00 00 02 8C 54
			15 00 00 00 00 00 02 8D 02
			15 00 00 00 00 00 02 8E 79
			15 00 00 00 00 00 02 8F 02
			15 00 00 00 00 00 02 90 7A
			15 00 00 00 00 00 02 91 02
			15 00 00 00 00 00 02 92 A7
			15 00 00 00 00 00 02 93 02
			15 00 00 00 00 00 02 94 DB
			15 00 00 00 00 00 02 95 03
			15 00 00 00 00 00 02 96 00
			15 00 00 00 00 00 02 97 03
			15 00 00 00 00 00 02 98 30
			15 00 00 00 00 00 02 99 03
			15 00 00 00 00 00 02 9A 53
			15 00 00 00 00 00 02 9B 03
			15 00 00 00 00 00 02 9C 81
			15 00 00 00 00 00 02 9D 03
			15 00 00 00 00 00 02 9E 8E
			15 00 00 00 00 00 02 9F 03
			15 00 00 00 00 00 02 A0 9D
			15 00 00 00 00 00 02 A2 03
			15 00 00 00 00 00 02 A3 AC
			15 00 00 00 00 00 02 A4 03
			15 00 00 00 00 00 02 A5 BC
			15 00 00 00 00 00 02 A6 03
			15 00 00 00 00 00 02 A7 CE
			15 00 00 00 00 00 02 A9 03
			15 00 00 00 00 00 02 AA E1
			15 00 00 00 00 00 02 AB 03
			15 00 00 00 00 00 02 AC F5
			15 00 00 00 00 00 02 AD 03
			15 01 00 00 00 00 02 AE FF
			//B(-) MCR cmd
			15 00 00 00 00 00 02 AF 01
			15 00 00 00 00 00 02 B0 CD
			15 00 00 00 00 00 02 B1 01
			15 00 00 00 00 00 02 B2 CF
			15 00 00 00 00 00 02 B3 01
			15 00 00 00 00 00 02 B4 D2
			15 00 00 00 00 00 02 B5 01
			15 00 00 00 00 00 02 B6 D6
			15 00 00 00 00 00 02 B7 01
			15 00 00 00 00 00 02 B8 D9
			15 00 00 00 00 00 02 B9 01
			15 00 00 00 00 00 02 BA DC
			15 00 00 00 00 00 02 BB 01
			15 00 00 00 00 00 02 BC DF
			15 00 00 00 00 00 02 BD 01
			15 00 00 00 00 00 02 BE E2
			15 00 00 00 00 00 02 BF 01
			15 00 00 00 00 00 02 C0 E6
			15 00 00 00 00 00 02 C1 01
			15 00 00 00 00 00 02 C2 F2
			15 00 00 00 00 00 02 C3 01
			15 00 00 00 00 00 02 C4 FF
			15 00 00 00 00 00 02 C5 02
			15 00 00 00 00 00 02 C6 17
			15 00 00 00 00 00 02 C7 02
			15 00 00 00 00 00 02 C8 2C
			15 00 00 00 00 00 02 C9 02
			15 00 00 00 00 00 02 CA 54
			15 00 00 00 00 00 02 CB 02
			15 00 00 00 00 00 02 CC 79
			15 00 00 00 00 00 02 CD 02
			15 00 00 00 00 00 02 CE 7A
			15 00 00 00 00 00 02 CF 02
			15 00 00 00 00 00 02 D0 A7
			15 00 00 00 00 00 02 D1 02
			15 00 00 00 00 00 02 D2 DB
			15 00 00 00 00 00 02 D3 03
			15 00 00 00 00 00 02 D4 00
			15 00 00 00 00 00 02 D5 03
			15 00 00 00 00 00 02 D6 30
			15 00 00 00 00 00 02 D7 03
			15 00 00 00 00 00 02 D8 53
			15 00 00 00 00 00 02 D9 03
			15 00 00 00 00 00 02 DA 81
			15 00 00 00 00 00 02 DB 03
			15 00 00 00 00 00 02 DC 8E
			15 00 00 00 00 00 02 DD 03
			15 00 00 00 00 00 02 DE 9D
			15 00 00 00 00 00 02 DF 03
			15 00 00 00 00 00 02 E0 AC
			15 00 00 00 00 00 02 E1 03
			15 00 00 00 00 00 02 E2 BC
			15 00 00 00 00 00 02 E3 03
			15 00 00 00 00 00 02 E4 CE
			15 00 00 00 00 00 02 E5 03
			15 00 00 00 00 00 02 E6 E1
			15 00 00 00 00 00 02 E7 03
			15 00 00 00 00 00 02 E8 F5
			15 00 00 00 00 00 02 E9 03
			15 00 00 00 00 00 02 EA FF
			//page selection cmd start
			15 00 00 00 00 00 02 FB 01
			15 01 00 00 00 00 02 FF 10
			//page selection cmd end
		];

		qcom,panel-reader-mode-off-command  = [
			//page selection cmd start
			15 00 00 00 00 00 02 FF 20
			//R(+) MCR cmd
			15 00 00 00 00 00 02 75 00
			15 00 00 00 00 00 02 76 00
			15 00 00 00 00 00 02 77 00
			15 00 00 00 00 00 02 78 1F
			15 00 00 00 00 00 02 79 00
			15 00 00 00 00 00 02 7A 56
			15 00 00 00 00 00 02 7B 00
			15 00 00 00 00 00 02 7C 7F
			15 00 00 00 00 00 02 7D 00
			15 00 00 00 00 00 02 7E 9E
			15 00 00 00 00 00 02 7F 00
			15 00 00 00 00 00 02 80 B8
			15 00 00 00 00 00 02 81 00
			15 00 00 00 00 00 02 82 CE
			15 00 00 00 00 00 02 83 00
			15 00 00 00 00 00 02 84 E2
			15 00 00 00 00 00 02 85 00
			15 00 00 00 00 00 02 86 F4
			15 00 00 00 00 00 02 87 01
			15 00 00 00 00 00 02 88 2D
			15 00 00 00 00 00 02 89 01
			15 00 00 00 00 00 02 8A 58
			15 00 00 00 00 00 02 8B 01
			15 00 00 00 00 00 02 8C 97
			15 00 00 00 00 00 02 8D 01
			15 00 00 00 00 00 02 8E C7
			15 00 00 00 00 00 02 8F 02
			15 00 00 00 00 00 02 90 0D
			15 00 00 00 00 00 02 91 02
			15 00 00 00 00 00 02 92 42
			15 00 00 00 00 00 02 93 02
			15 00 00 00 00 00 02 94 44
			15 00 00 00 00 00 02 95 02
			15 00 00 00 00 00 02 96 79
			15 00 00 00 00 00 02 97 02
			15 00 00 00 00 00 02 98 B4
			15 00 00 00 00 00 02 99 02
			15 00 00 00 00 00 02 9A DA
			15 00 00 00 00 00 02 9B 03
			15 00 00 00 00 00 02 9C 0B
			15 00 00 00 00 00 02 9D 03
			15 00 00 00 00 00 02 9E 2F
			15 00 00 00 00 00 02 9F 03
			15 00 00 00 00 00 02 A0 60
			15 00 00 00 00 00 02 A2 03
			15 00 00 00 00 00 02 A3 70
			15 00 00 00 00 00 02 A4 03
			15 00 00 00 00 00 02 A5 81
			15 00 00 00 00 00 02 A6 03
			15 00 00 00 00 00 02 A7 93
			15 00 00 00 00 00 02 A9 03
			15 00 00 00 00 00 02 AA A7
			15 00 00 00 00 00 02 AB 03
			15 00 00 00 00 00 02 AC BE
			15 00 00 00 00 00 02 AD 03
			15 00 00 00 00 00 02 AE D6
			15 00 00 00 00 00 02 AF 03
			15 00 00 00 00 00 02 B0 F1
			15 00 00 00 00 00 02 B1 03
			15 01 00 00 00 00 02 B2 FF
			//R(-) MCR cmd
			15 00 00 00 00 00 02 B3 00
			15 00 00 00 00 00 02 B4 00
			15 00 00 00 00 00 02 B5 00
			15 00 00 00 00 00 02 B6 1F
			15 00 00 00 00 00 02 B7 00
			15 00 00 00 00 00 02 B8 56
			15 00 00 00 00 00 02 B9 00
			15 00 00 00 00 00 02 BA 7F
			15 00 00 00 00 00 02 BB 00
			15 00 00 00 00 00 02 BC 9E
			15 00 00 00 00 00 02 BD 00
			15 00 00 00 00 00 02 BE B8
			15 00 00 00 00 00 02 BF 00
			15 00 00 00 00 00 02 C0 CE
			15 00 00 00 00 00 02 C1 00
			15 00 00 00 00 00 02 C2 E2
			15 00 00 00 00 00 02 C3 00
			15 00 00 00 00 00 02 C4 F4
			15 00 00 00 00 00 02 C5 01
			15 00 00 00 00 00 02 C6 2D
			15 00 00 00 00 00 02 C7 01
			15 00 00 00 00 00 02 C8 58
			15 00 00 00 00 00 02 C9 01
			15 00 00 00 00 00 02 CA 97
			15 00 00 00 00 00 02 CB 01
			15 00 00 00 00 00 02 CC C7
			15 00 00 00 00 00 02 CD 02
			15 00 00 00 00 00 02 CE 0D
			15 00 00 00 00 00 02 CF 02
			15 00 00 00 00 00 02 D0 42
			15 00 00 00 00 00 02 D1 02
			15 00 00 00 00 00 02 D2 44
			15 00 00 00 00 00 02 D3 02
			15 00 00 00 00 00 02 D4 79
			15 00 00 00 00 00 02 D5 02
			15 00 00 00 00 00 02 D6 B4
			15 00 00 00 00 00 02 D7 02
			15 00 00 00 00 00 02 D8 DA
			15 00 00 00 00 00 02 D9 03
			15 00 00 00 00 00 02 DA 0B
			15 00 00 00 00 00 02 DB 03
			15 00 00 00 00 00 02 DC 2F
			15 00 00 00 00 00 02 DD 03
			15 00 00 00 00 00 02 DE 60
			15 00 00 00 00 00 02 DF 03
			15 00 00 00 00 00 02 E0 70
			15 00 00 00 00 00 02 E1 03
			15 00 00 00 00 00 02 E2 81
			15 00 00 00 00 00 02 E3 03
			15 00 00 00 00 00 02 E4 93
			15 00 00 00 00 00 02 E5 03
			15 00 00 00 00 00 02 E6 A7
			15 00 00 00 00 00 02 E7 03
			15 00 00 00 00 00 02 E8 BE
			15 00 00 00 00 00 02 E9 03
			15 00 00 00 00 00 02 EA D6
			15 00 00 00 00 00 02 EB 03
			15 00 00 00 00 00 02 EC F1
			15 00 00 00 00 00 02 ED 03
			15 01 00 00 00 00 02 EE FF
			//G(+) MCR cmd
			15 00 00 00 00 00 02 EF 00
			15 00 00 00 00 00 02 F0 00
			15 00 00 00 00 00 02 F1 00
			15 00 00 00 00 00 02 F2 20
			15 00 00 00 00 00 02 F3 00
			15 00 00 00 00 00 02 F4 59
			15 00 00 00 00 00 02 F5 00
			15 00 00 00 00 00 02 F6 82
			15 00 00 00 00 00 02 F7 00
			15 00 00 00 00 00 02 F8 A0
			15 00 00 00 00 00 02 F9 00
			15 00 00 00 00 00 02 FA BA
			//page selection cmd start
			15 00 00 00 00 00 02 FB 01
			15 01 00 00 00 00 02 FF 21
			//page selection cmd end
			15 00 00 00 00 00 02 00 00
			15 00 00 00 00 00 02 01 D0
			15 00 00 00 00 00 02 02 00
			15 00 00 00 00 00 02 03 E4
			15 00 00 00 00 00 02 04 00
			15 00 00 00 00 00 02 05 F5
			15 00 00 00 00 00 02 06 01
			15 00 00 00 00 00 02 07 2F
			15 00 00 00 00 00 02 08 01
			15 00 00 00 00 00 02 09 59
			15 00 00 00 00 00 02 0A 01
			15 00 00 00 00 00 02 0B 98
			15 00 00 00 00 00 02 0C 01
			15 00 00 00 00 00 02 0D C6
			15 00 00 00 00 00 02 0E 02
			15 00 00 00 00 00 02 0F 0D
			15 00 00 00 00 00 02 10 02
			15 00 00 00 00 00 02 11 43
			15 00 00 00 00 00 02 12 02
			15 00 00 00 00 00 02 13 44
			15 00 00 00 00 00 02 14 02
			15 00 00 00 00 00 02 15 79
			15 00 00 00 00 00 02 16 02
			15 00 00 00 00 00 02 17 B4
			15 00 00 00 00 00 02 18 02
			15 00 00 00 00 00 02 19 DA
			15 00 00 00 00 00 02 1A 03
			15 00 00 00 00 00 02 1B 0C
			15 00 00 00 00 00 02 1C 03
			15 00 00 00 00 00 02 1D 30
			15 00 00 00 00 00 02 1E 03
			15 00 00 00 00 00 02 1F 61
			15 00 00 00 00 00 02 20 03
			15 00 00 00 00 00 02 21 71
			15 00 00 00 00 00 02 22 03
			15 00 00 00 00 00 02 23 82
			15 00 00 00 00 00 02 24 03
			15 00 00 00 00 00 02 25 94
			15 00 00 00 00 00 02 26 03
			15 00 00 00 00 00 02 27 A8
			15 00 00 00 00 00 02 28 03
			15 00 00 00 00 00 02 29 BE
			15 00 00 00 00 00 02 2A 03
			15 00 00 00 00 00 02 2B D7
			15 00 00 00 00 00 02 2D 03
			15 00 00 00 00 00 02 2F F1
			15 00 00 00 00 00 02 30 03
			15 01 00 00 00 00 02 31 FF
			//G(-) MCR cmd
			15 00 00 00 00 00 02 32 00
			15 00 00 00 00 00 02 33 00
			15 00 00 00 00 00 02 34 00
			15 00 00 00 00 00 02 35 20
			15 00 00 00 00 00 02 36 00
			15 00 00 00 00 00 02 37 59
			15 00 00 00 00 00 02 38 00
			15 00 00 00 00 00 02 39 82
			15 00 00 00 00 00 02 3A 00
			15 00 00 00 00 00 02 3B A0
			15 00 00 00 00 00 02 3D 00
			15 00 00 00 00 00 02 3F BA
			15 00 00 00 00 00 02 40 00
			15 00 00 00 00 00 02 41 D0
			15 00 00 00 00 00 02 42 00
			15 00 00 00 00 00 02 43 E4
			15 00 00 00 00 00 02 44 00
			15 00 00 00 00 00 02 45 F5
			15 00 00 00 00 00 02 46 01
			15 00 00 00 00 00 02 47 2F
			15 00 00 00 00 00 02 48 01
			15 00 00 00 00 00 02 49 59
			15 00 00 00 00 00 02 4A 01
			15 00 00 00 00 00 02 4B 98
			15 00 00 00 00 00 02 4C 01
			15 00 00 00 00 00 02 4D C6
			15 00 00 00 00 00 02 4E 02
			15 00 00 00 00 00 02 4F 0D
			15 00 00 00 00 00 02 50 02
			15 00 00 00 00 00 02 51 43
			15 00 00 00 00 00 02 52 02
			15 00 00 00 00 00 02 53 44
			15 00 00 00 00 00 02 54 02
			15 00 00 00 00 00 02 55 79
			15 00 00 00 00 00 02 56 02
			15 00 00 00 00 00 02 58 B4
			15 00 00 00 00 00 02 59 02
			15 00 00 00 00 00 02 5A DA
			15 00 00 00 00 00 02 5B 03
			15 00 00 00 00 00 02 5C 0C
			15 00 00 00 00 00 02 5D 03
			15 00 00 00 00 00 02 5E 30
			15 00 00 00 00 00 02 5F 03
			15 00 00 00 00 00 02 60 61
			15 00 00 00 00 00 02 61 03
			15 00 00 00 00 00 02 62 71
			15 00 00 00 00 00 02 63 03
			15 00 00 00 00 00 02 64 82
			15 00 00 00 00 00 02 65 03
			15 00 00 00 00 00 02 66 94
			15 00 00 00 00 00 02 67 03
			15 00 00 00 00 00 02 68 A8
			15 00 00 00 00 00 02 69 03
			15 00 00 00 00 00 02 6A BE
			15 00 00 00 00 00 02 6B 03
			15 00 00 00 00 00 02 6C D7
			15 00 00 00 00 00 02 6D 03
			15 00 00 00 00 00 02 6E F1
			15 00 00 00 00 00 02 6F 03
			15 01 00 00 00 00 02 70 FF
			//B(+) MCR cmd
			15 00 00 00 00 00 02 71 00
			15 00 00 00 00 00 02 72 00
			15 00 00 00 00 00 02 73 00
			15 00 00 00 00 00 02 74 23
			15 00 00 00 00 00 02 75 00
			15 00 00 00 00 00 02 76 61
			15 00 00 00 00 00 02 77 00
			15 00 00 00 00 00 02 78 8C
			15 00 00 00 00 00 02 79 00
			15 00 00 00 00 00 02 7A AA
			15 00 00 00 00 00 02 7B 00
			15 00 00 00 00 00 02 7C C3
			15 00 00 00 00 00 02 7D 00
			15 00 00 00 00 00 02 7E DA
			15 00 00 00 00 00 02 7F 00
			15 00 00 00 00 00 02 80 EE
			15 00 00 00 00 00 02 81 00
			15 00 00 00 00 00 02 82 FF
			15 00 00 00 00 00 02 83 01
			15 00 00 00 00 00 02 84 37
			15 00 00 00 00 00 02 85 01
			15 00 00 00 00 00 02 86 61
			15 00 00 00 00 00 02 87 01
			15 00 00 00 00 00 02 88 A0
			15 00 00 00 00 00 02 89 01
			15 00 00 00 00 00 02 8A CE
			15 00 00 00 00 00 02 8B 02
			15 00 00 00 00 00 02 8C 12
			15 00 00 00 00 00 02 8D 02
			15 00 00 00 00 00 02 8E 49
			15 00 00 00 00 00 02 8F 02
			15 00 00 00 00 00 02 90 4A
			15 00 00 00 00 00 02 91 02
			15 00 00 00 00 00 02 92 7C
			15 00 00 00 00 00 02 93 02
			15 00 00 00 00 00 02 94 B7
			15 00 00 00 00 00 02 95 02
			15 00 00 00 00 00 02 96 DC
			15 00 00 00 00 00 02 97 03
			15 00 00 00 00 00 02 98 0E
			15 00 00 00 00 00 02 99 03
			15 00 00 00 00 00 02 9A 31
			15 00 00 00 00 00 02 9B 03
			15 00 00 00 00 00 02 9C 63
			15 00 00 00 00 00 02 9D 03
			15 00 00 00 00 00 02 9E 72
			15 00 00 00 00 00 02 9F 03
			15 00 00 00 00 00 02 A0 83
			15 00 00 00 00 00 02 A2 03
			15 00 00 00 00 00 02 A3 95
			15 00 00 00 00 00 02 A4 03
			15 00 00 00 00 00 02 A5 A9
			15 00 00 00 00 00 02 A6 03
			15 00 00 00 00 00 02 A7 BF
			15 00 00 00 00 00 02 A9 03
			15 00 00 00 00 00 02 AA D7
			15 00 00 00 00 00 02 AB 03
			15 00 00 00 00 00 02 AC F2
			15 00 00 00 00 00 02 AD 03
			15 00 00 00 00 00 02 AE FF
			//B(-) MCR cmd
			15 00 00 00 00 00 02 AF 00
			15 00 00 00 00 00 02 B0 00
			15 00 00 00 00 00 02 B1 00
			15 00 00 00 00 00 02 B2 23
			15 00 00 00 00 00 02 B3 00
			15 00 00 00 00 00 02 B4 61
			15 00 00 00 00 00 02 B5 00
			15 00 00 00 00 00 02 B6 8C
			15 00 00 00 00 00 02 B7 00
			15 00 00 00 00 00 02 B8 AA
			15 00 00 00 00 00 02 B9 00
			15 00 00 00 00 00 02 BA C3
			15 00 00 00 00 00 02 BB 00
			15 00 00 00 00 00 02 BC DA
			15 00 00 00 00 00 02 BD 00
			15 00 00 00 00 00 02 BE EE
			15 00 00 00 00 00 02 BF 00
			15 00 00 00 00 00 02 C0 FF
			15 00 00 00 00 00 02 C1 01
			15 00 00 00 00 00 02 C2 37
			15 00 00 00 00 00 02 C3 01
			15 00 00 00 00 00 02 C4 61
			15 00 00 00 00 00 02 C5 01
			15 00 00 00 00 00 02 C6 A0
			15 00 00 00 00 00 02 C7 01
			15 00 00 00 00 00 02 C8 CE
			15 00 00 00 00 00 02 C9 02
			15 00 00 00 00 00 02 CA 12
			15 00 00 00 00 00 02 CB 02
			15 00 00 00 00 00 02 CC 49
			15 00 00 00 00 00 02 CD 02
			15 00 00 00 00 00 02 CE 4A
			15 00 00 00 00 00 02 CF 02
			15 00 00 00 00 00 02 D0 7C
			15 00 00 00 00 00 02 D1 02
			15 00 00 00 00 00 02 D2 B7
			15 00 00 00 00 00 02 D3 02
			15 00 00 00 00 00 02 D4 DC
			15 00 00 00 00 00 02 D5 03
			15 00 00 00 00 00 02 D6 0E
			15 00 00 00 00 00 02 D7 03
			15 00 00 00 00 00 02 D8 31
			15 00 00 00 00 00 02 D9 03
			15 00 00 00 00 00 02 DA 63
			15 00 00 00 00 00 02 DB 03
			15 00 00 00 00 00 02 DC 72
			15 00 00 00 00 00 02 DD 03
			15 00 00 00 00 00 02 DE 83
			15 00 00 00 00 00 02 DF 03
			15 00 00 00 00 00 02 E0 95
			15 00 00 00 00 00 02 E1 03
			15 00 00 00 00 00 02 E2 A9
			15 00 00 00 00 00 02 E3 03
			15 00 00 00 00 00 02 E4 BF
			15 00 00 00 00 00 02 E5 03
			15 00 00 00 00 00 02 E6 D7
			15 00 00 00 00 00 02 E7 03
			15 00 00 00 00 00 02 E8 F2
			15 00 00 00 00 00 02 E9 03
			15 00 00 00 00 00 02 EA FF
			//page selection cmd start
			15 00 00 00 00 00 02 FB 01
			15 01 00 00 00 00 02 FF 10
			//page selection cmd end
		];

		qcom,panel-reader-mode-mono-enable-command = [
			15 01 00 00 00 00 02 FF 10
			15 01 00 00 00 00 02 55 80
		];

		qcom,panel-reader-mode-mono-disable-command = [
			15 01 00 00 00 00 02 FF 10
			15 01 00 00 00 00 02 55 00
		];

		qcom,mdss-dsi-on-command-state = "dsi_lp_mode";
		qcom,mdss-dsi-off-command-state = "dsi_hs_mode";
		qcom,esd-check-enabled;
		qcom,mdss-dsi-panel-status-command = [06 01 00 01 05 00 02 0A 08];
		qcom,mdss-dsi-panel-status-command-state = "dsi_hs_mode";
		qcom,mdss-dsi-panel-status-check-mode = "reg_read";
		qcom,mdss-dsi-panel-status-read-length = <1>;
		qcom,mdss-dsi-panel-status-value = <0x9c>;
		qcom,mdss-dsi-reader-mode-command-state = "dsi_hs_mode";
		qcom,mdss-dsi-h-sync-pulse = <0>;
		qcom,mdss-dsi-lane-map = "lane_map_0123";
		qcom,mdss-dsi-bllp-eof-power-mode;
		qcom,mdss-dsi-bllp-power-mode;
		qcom,mdss-dsi-lane-0-state;
		qcom,mdss-dsi-lane-1-state;
		qcom,mdss-dsi-lane-2-state;
		qcom,mdss-dsi-lane-3-state;
		qcom,mdss-dsi-panel-timings = [DC 34 22 00 64 66 28 38 32 03 04 00]; /* TLPX is 62.5ns */

		qcom,mdss-dsi-reset-sequence = <1 10>, <1 12>, <1 10>; /* reset is always HIGH */
		qcom,mdss-dsi-t-clk-post = <0x3>;
		qcom,mdss-dsi-t-clk-pre = <0x2A>;
		qcom,mdss-dsi-dma-trigger = "trigger_sw";

		/* KYH 20150904 modified from none to trigger_sw */
		qcom,mdss-dsi-mdp-trigger = "trigger_sw";

		qcom,cont-splash-enabled;
		//qcom,mdss-dsi-force-clock-lane-hs;

		qcom,mdss-dsi-traffic-mode = "non_burst_sync_event";

		qcom,mdss-dsi-post-init-delay = <1>;

		lge,blmap-size = <256>;
		lge,blmap = <
			0 25 25 25 25 25 25 25 25 25				/* 0 ~ 9 */
			25 26 27 28 30 31 32 34 35 36				/* 10 ~ 19 */
			38 39 40 41 43 44 45 47 48 49				/* 20 ~ 29 */
			51 52 53 54 56 57 58 60 61 62				/* 30 ~ 39 */
			64 65 66 67 69 70 71 73 74 75				/* 40 ~ 49 */
			77 78 79 80 82 83 84 86 87 88				/* 50 ~ 59 */
			90 94 99 104 109 113 118 123 128 132			/* 60 ~ 69 */
			137 142 147 152 156 161 166 171 175 180			/* 70 ~ 79 */
			185 190 194 199 204 209 214 218 223 228			/* 80 ~ 89 */
			233 237 242 247 252 256 261 266 271 276			/* 90 ~ 99 */
			280 285 290 295 299 304 309 314 319 327			/* 100 ~ 109 */
			336 344 353 361 370 378 387 395 404 412			/* 110 ~ 119 */
			421 429 438 446 455 464 472 481 489 498			/* 120 ~ 129 */
			506 515 523 532 540 549 557 566 574 583			/* 130 ~ 139 */
			591 600 609 617 626 634 643 651 660 668			/* 140 ~ 149 */
			677 685 694 702 711 719 728 737 750 763			/* 150 ~ 159 */
			776 790 803 816 830 843 856 869 883 896			/* 160 ~ 169 */
			909 923 936 949 962 976 989 1002 1016 1029		/* 170 ~ 179 */
			1042 1055 1069 1082 1095 1109 1122 1135 1148 1162	/* 180 ~ 189 */
			1175 1188 1202 1215 1228 1241 1255 1268 1281 1295	/* 190 ~ 199 */
			1308 1321 1334 1348 1361 1374 1388 1406 1424 1442	/* 200 ~ 209 */
			1460 1478 1496 1514 1532 1550 1569 1587 1605 1623	/* 210 ~ 219 */
			1641 1659 1677 1695 1713 1731 1750 1768 1786 1804	/* 220 ~ 229 */
			1822 1840 1858 1876 1894 1912 1931 1949 1967 1985	/* 230 ~ 239 */
			2003 2021 2039 2057 2075 2093 2112 2130 2148 2166	/* 240 ~ 249 */
			2184 2202 2220 2238 2256 2275				/* 250 ~ 255 */
		>;

		lge,blmap-hl = <
			0 2275 2275 2275 2275 2275 2275 2275 2275 2275		/* 0 ~ 9 */
			2275 2280 2286 2292 2298 2304 2310 2316 2322 2328	/* 10 ~ 19 */
			2334 2340 2346 2351 2357 2363 2369 2375 2381 2387	/* 20 ~ 29 */
			2393 2399 2405 2411 2417 2423 2428 2434 2440 2446	/* 30 ~ 39 */
			2452 2458 2464 2470 2476 2482 2488 2494 2500 2505	/* 40 ~ 49 */
			2511 2517 2523 2529 2535 2541 2547 2553 2559 2565	/* 50 ~ 59 */
			2571 2577 2582 2588 2594 2600 2606 2612 2618 2624	/* 60 ~ 69 */
			2630 2636 2642 2648 2654 2659 2665 2671 2677 2683	/* 70 ~ 79 */
			2689 2695 2701 2707 2713 2719 2725 2731 2736 2742	/* 80 ~ 89 */
			2748 2754 2760 2766 2772 2778 2784 2790 2796 2802	/* 90 ~ 99 */
			2808 2813 2819 2825 2831 2837 2843 2849 2855 2861	/* 100 ~ 109 */
			2867 2873 2879 2885 2890 2896 2902 2908 2914 2920	/* 110 ~ 119 */
			2926 2932 2938 2944 2950 2956 2962 2967 2973 2979	/* 120 ~ 129 */
			2985 2991 2997 3003 3009 3015 3021 3027 3033 3038	/* 130 ~ 139 */
			3044 3050 3056 3062 3068 3074 3080 3086 3092 3098	/* 140 ~ 149 */
			3104 3110 3115 3121 3127 3133 3139 3145 3151 3157	/* 150 ~ 159 */
			3163 3169 3175 3181 3187 3192 3198 3204 3210 3216	/* 160 ~ 169 */
			3222 3228 3234 3240 3246 3252 3258 3264 3269 3275	/* 170 ~ 179 */
			3281 3287 3293 3299 3305 3311 3317 3323 3329 3335	/* 180 ~ 189 */
			3341 3346 3352 3358 3364 3370 3376 3382 3388 3394	/* 190 ~ 199 */
			3400 3406 3412 3418 3423 3429 3435 3441 3447 3453	/* 200 ~ 209 */
			3459 3465 3471 3477 3483 3489 3495 3500 3506 3512	/* 210 ~ 219 */
			3518 3524 3530 3536 3542 3548 3554 3560 3566 3572	/* 220 ~ 229 */
			3577 3583 3589 3595 3601 3607 3613 3619 3625 3631	/* 230 ~ 239 */
			3637 3643 3649 3654 3660 3666 3672 3678 3684 3690	/* 240 ~ 249 */
			3696 3702 3708 3714 3720 3726				/* 250 ~ 255 */
		>;
	};
};
